/*
 * Copyright (c) 2026 AIFoundry
 * SPDX-License-Identifier: Apache-2.0
 */

/dts-v1/;

#include <aifoundry/etsoc1-sp.dtsi>

/ {
	model = "AIFoundry ET-SOC1 Service Processor";
	compatible = "aifoundry,etsoc1-sp";

	chosen {
		zephyr,console = &uart0;
		zephyr,shell-uart = &uart0;
		zephyr,sram = &sp_sram;
	};
};

&uart0 {
	compatible = "aifoundry,etsoc-dw-apb-uart";
	status = "okay";
	current-speed = <115200>;
};
