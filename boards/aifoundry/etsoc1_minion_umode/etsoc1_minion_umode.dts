/*
 * Copyright (c) 2026 AIFoundry
 * SPDX-License-Identifier: Apache-2.0
 */

/dts-v1/;

#include <aifoundry/etsoc1-minion-umode.dtsi>

/ {
	model = "AIFoundry ET-SoC1 Minion (U-mode Zephyr)";
	compatible = "aifoundry,etsoc1-minion-umode";

	chosen {
		zephyr,sram = &umode_region;
	};
};
