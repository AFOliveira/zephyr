/*
 * Copyright (c) 2026 AIFoundry
 * SPDX-License-Identifier: Apache-2.0
 */

/dts-v1/;

#include <aifoundry/erbium-minion.dtsi>

/ {
	model = "AIFoundry Erbium Minion";
	compatible = "aifoundry,erbium-minion";

	chosen {
		zephyr,console = &uart0;
		zephyr,shell-uart = &uart0;
		zephyr,sram = &mram;
	};
};

&uart0 {
	status = "okay";
	current-speed = <115200>;
};
