## arch/riscv/aif/Kconfig
```kconfig
# Copyright (c) 2026 AIFoundry
# SPDX-License-Identifier: Apache-2.0

config AIF_ET_ISA_MIGRATION
	bool "AIFoundry ET ISA migration custom instruction intrinsics"
	help
	  Enable include/zephyr/arch/riscv/aif/xaifet.h encoders and the
	  isa_migration_smoke sample for the nine approved custom-0/custom-1
	  migration targets in harness/config/encoding_plan.yaml.

config AIF_ET_ISA_MIGRATION_PATCHED_ASM
	bool "Assemble migration mnemonics with patched Binutils"
	depends on AIF_ET_ISA_MIGRATION
	default y
	help
	  Build src/aif_mnemonic_emitters.S with the patched xaifet assembler
	  from the Phase 2 toolchain workspace and verify disassembly with the
	  patched objdump. Stock Zephyr SDK .word emitters remain as compile-only
	  fallback in aif_compile_only_emitters.c.
```

## arch/riscv/custom/aifoundry/Kconfig
```kconfig
# Copyright (c) 2026 AIFoundry
# SPDX-License-Identifier: Apache-2.0

config SOC_AIFOUNDRY_ERBIUM_UMODE
	bool "AIFoundry Erbium M->U->M round-trip launcher"
	depends on SOC_ERBIUM_MINION
	help
	  Enable the minimal M-mode launcher / U-mode return-trip dispatcher
	  used to run a compute kernel in RISC-V U-mode on an Erbium Minion
	  core.  This is a self-contained slice (no Zephyr userspace/PMP) that
	  provides aifoundry_launch_umode() and handles the cm-umode syscall
	  ABI for SYSCALL_CACHE_OPS_INVALIDATE and SYSCALL_RETURN_FROM_KERNEL.
```

## arch/riscv/custom/et_minion/Kconfig
```kconfig
# Copyright (c) 2025 AIFoundry
# SPDX-License-Identifier: Apache-2.0

config RISCV_SOC_HAS_ET_MINION
	bool
	help
	  Enable ET-Minion specific features including cache management.

if RISCV_SOC_HAS_ET_MINION

config DCACHE_LINE_SIZE
	default 64

config ICACHE_LINE_SIZE
	default 64

endif # RISCV_SOC_HAS_ET_MINION
```

## boards/aifoundry/erbium_minion/Kconfig.defconfig
```kconfig
# Copyright (c) 2026 AIFoundry
# SPDX-License-Identifier: Apache-2.0

if BOARD_ERBIUM_MINION

config BOARD
	default "erbium_minion"

endif
```

## boards/aifoundry/erbium_minion/Kconfig.erbium_minion
```kconfig
# Copyright (c) 2026 AIFoundry
# SPDX-License-Identifier: Apache-2.0

config BOARD_ERBIUM_MINION
	select SOC_ERBIUM_MINION
```

## boards/aifoundry/erbium_minion/board.yml
```yaml
board:
  name: erbium_minion
  full_name: Erbium Minion
  vendor: aifoundry
  socs:
  - name: erbium_minion
```

## boards/aifoundry/etsoc1_minion_umode/Kconfig.defconfig
```kconfig
# Copyright (c) 2026 AIFoundry
# SPDX-License-Identifier: Apache-2.0

if BOARD_ETSOC1_MINION_UMODE

config BOARD
	default "etsoc1_minion_umode"

endif
```

## boards/aifoundry/etsoc1_minion_umode/Kconfig.etsoc1_minion_umode
```kconfig
# Copyright (c) 2026 AIFoundry
# SPDX-License-Identifier: Apache-2.0

config BOARD_ETSOC1_MINION_UMODE
	select SOC_ETSOC1_MINION_UMODE
```

## boards/aifoundry/etsoc1_minion_umode/board.yml
```yaml
board:
  name: etsoc1_minion_umode
  full_name: ET-SoC1 Minion (Zephyr-in-U-mode)
  vendor: aifoundry
  socs:
  - name: etsoc1_minion_umode
```

## boards/aifoundry/etsoc1_minion_umode/etsoc1_minion_umode_defconfig
```kconfig
# Copyright (c) 2026 AIFoundry
# SPDX-License-Identifier: Apache-2.0

CONFIG_RISCV_RUN_IN_UMODE=y
CONFIG_FPU=y
CONFIG_PRINTK=y
CONFIG_XIP=n
CONFIG_SERIAL=n
CONFIG_CONSOLE=n
```

## boards/aifoundry/etsoc1_sp/Kconfig.defconfig
```kconfig
# Copyright (c) 2026 AIFoundry
# SPDX-License-Identifier: Apache-2.0

if BOARD_ETSOC1_SP

config BOARD
	default "etsoc1_sp"

endif
```

## boards/aifoundry/etsoc1_sp/Kconfig.etsoc1_sp
```kconfig
# Copyright (c) 2026 AIFoundry
# SPDX-License-Identifier: Apache-2.0

config BOARD_ETSOC1_SP
	select SOC_ETSOC1_SP
```

## boards/aifoundry/etsoc1_sp/board.yml
```yaml
boards:
  - name: etsoc1_sp
    full_name: AIFoundry ET-SOC1 Service Processor
    vendor: aifoundry
    socs:
      - name: etsoc1_sp
```

## boards/aifoundry/etsoc1_sp/etsoc1_sp_defconfig
```kconfig
# Copyright (c) 2026 AIFoundry
# SPDX-License-Identifier: Apache-2.0

CONFIG_RV_BOOT_HART=16256

CONFIG_FPU=y
CONFIG_FPU_SHARING=y

CONFIG_CONSOLE=y
CONFIG_UART_CONSOLE=y
CONFIG_SERIAL=y
CONFIG_UART_ETSOC_DW_APB=y

CONFIG_SYS_CLOCK_TICKS_PER_SEC=1000
CONFIG_XIP=n

CONFIG_RISCV_MACHINE_TIMER=y
CONFIG_RISCV_TRAP_HANDLER_ALIGNMENT=4096
```

## drivers/serial/Kconfig.aifoundry_trace
```kconfig
# Copyright (c) 2026 AIFoundry
# SPDX-License-Identifier: Apache-2.0

config UART_AIFOUNDRY_TRACE
	bool "AIFoundry trace-ring UART driver"
	default y
	depends on DT_HAS_AIFOUNDRY_UMODE_TRACE_UART_ENABLED
	select SERIAL_HAS_DRIVER
	select SERIAL_SUPPORT_INTERRUPT
	help
	  Virtual UART driver that forwards bytes through aifoundry_log
	  (the AIFoundry runtime HAL).  Intended for U-mode targets where
	  the kernel has no direct UART access, so generic Zephyr UART
	  consumers (printk, ArduinoCore-zephyr's Serial) can still emit
	  to the et-trace ring.
```

## drivers/serial/Kconfig.etsoc_dw_apb
```kconfig
config UART_ETSOC_DW_APB
	bool "AIFoundry ET-SOC1 DW_apb_uart"
	depends on DT_HAS_AIFOUNDRY_ETSOC_DW_APB_UART_ENABLED
	select SERIAL_HAS_DRIVER
	help
	  Enable the AIFoundry ET-SOC1 DW_apb_uart driver. This driver wraps
	  the DW_apb_uart register programming used by the ET common libraries
	  (FreeRTOS stack) and uses the THRE semantics expected by that code.
```

## drivers/serial/Kconfig.shakti
```kconfig
# Copyright (c) 2025 AIFoundry
# SPDX-License-Identifier: Apache-2.0

config UART_SHAKTI
	bool "AIFoundry Shakti UART driver"
	default y
	depends on DT_HAS_AIFOUNDRY_SHAKTI_UART_ENABLED
	select SERIAL_HAS_DRIVER
	select SERIAL_SUPPORT_INTERRUPT
	help
	  Enable the AIFoundry Shakti UART driver for Erbium.
```

## dts/bindings/serial/aifoundry,etsoc-dw-apb-uart.yaml
```yaml
description: AIFoundry ET-SOC1 DW_apb_uart

compatible: "aifoundry,etsoc-dw-apb-uart"

include: uart-controller.yaml

properties:
  reg-shift:
    type: int
    description: Register offset shift (kept for compatibility with ns16550 DTS).
```

## dts/bindings/serial/aifoundry,shakti-uart.yaml
```yaml
# Copyright (c) 2025 AIFoundry
# SPDX-License-Identifier: Apache-2.0

description: AIFoundry Shakti UART

compatible: "aifoundry,shakti-uart"

include: uart-controller.yaml

properties:
  reg:
    required: true

  interrupts:
    required: true

  reg-shift:
    type: int
    required: true
    description: quantity to shift the register offsets by

  clock-frequency:
    required: true
  current-speed:
    required: true
```

## dts/bindings/serial/aifoundry,umode-trace-uart.yaml
```yaml
# Copyright (c) 2026 AIFoundry
# SPDX-License-Identifier: Apache-2.0

description: |
  Virtual UART that forwards bytes through the AIFoundry runtime HAL
  (aifoundry_log).  On etsoc1_minion_umode this lands in the per-hart
  et-trace ring; on any other target it is just an aifoundry_log sink.

  Has no register window, no IRQ line, no clock — purely a software
  shim so generic Zephyr UART consumers (e.g. ArduinoCore-zephyr's
  ZephyrSerial) work on a U-mode target with no UART access.

compatible: "aifoundry,umode-trace-uart"

include: uart-controller.yaml
```

## samples/subsys/umode_hello/sample.yaml
```yaml
sample:
  name: Zephyr in U-mode Hello
  description: Hello-world sanity check for Zephyr running as an ET-SoC1 cm-umode kernel.
tests:
  sample.subsys.umode_hello:
    platform_allow:
      - etsoc1_minion_umode
    tags: riscv umode
    harness: console
    harness_config:
      type: one_line
      regex:
        - "Hello from Zephyr in U-mode"
```
