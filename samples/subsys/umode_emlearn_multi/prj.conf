## CMakeLists.txt
```
# Copyright (c) 2026 AIFoundry
# SPDX-License-Identifier: Apache-2.0
#
# emlearn-style inference demo on Zephyr.  Runs a small hand-written
# decision-tree classifier (representative of emlearn's C output) over
# a handful of test vectors, prints each prediction, then exits via
# SYSCALL_RETURN_FROM_KERNEL.  No OSKERN syscalls needed — the only
# ecall made is the final kernel-exit.

cmake_minimum_required(VERSION 3.20.0)

find_package(Zephyr REQUIRED HINTS $ENV{ZEPHYR_BASE})
project(umode_emlearn_multi)

target_sources(app PRIVATE
    src/main.c
)
# emlearn-generated classifiers are header-only (static inline trees +
# one extern predict() per model).  Pull our app's src/ onto the
# include path so #include "iris_tree.h" / "iris_rf.h" / "wine_rf.h"
# resolves; emlearn's eml_*.h come in via CONFIG_EMLEARN=y.
target_include_directories(app PRIVATE src)

# cm-umode headers supply the `syscall()` helper and SYSCALL_RETURN_FROM_KERNEL.
# Only needed on the U-mode build (ET-SoC1); Erbium Zephyr-M doesn't ecall.
if(CONFIG_RISCV_RUN_IN_UMODE)
    if(NOT DEFINED CM_UMODE_ROOT)
        set(CM_UMODE_ROOT /home/afonso/et-platform/et-common-libs)
    endif()
    target_include_directories(app PRIVATE ${CM_UMODE_ROOT}/include)
    target_compile_definitions(app PRIVATE asm=__asm__)
endif()

zephyr_ld_options(-Wl,--emit-relocs)
```

## sample.yaml
```
sample:
  name: emlearn-style inference on Zephyr
  description: Pure-compute decision tree classifier, exits via RETURN_FROM_KERNEL syscall.
tests:
  sample.subsys.umode_emlearn:
    platform_allow:
      - etsoc1_minion_umode
      - erbium_minion
    tags: riscv umode emlearn ml
    harness: console
    harness_config:
      type: one_line
      regex:
        - "emlearn-app: done, exiting kernel"
```

## prj.conf
```kconfig
# Copyright (c) 2026 AIFoundry
# SPDX-License-Identifier: Apache-2.0
#
# Same baseline as umode_emlearn, plus a bigger main stack so it can
# be carved into 4 per-shire slices by entry.S in phase 2 of the POC.
# 4 shires × 4 KiB each = 16 KiB total stack region.

CONFIG_MULTITHREADING=n
CONFIG_BOOT_BANNER=n

# Per-shire stack carving in entry.S: 4 shires x 4096 bytes = 16384.
# CONFIG_MAIN_STACK_SIZE must therefore be at least 4 * 4096 so that
# z_main_stack has room for all four slices.
CONFIG_AIFOUNDRY_PER_SHIRE_STACK=y
CONFIG_AIFOUNDRY_PER_SHIRE_STACK_SIZE=4096
CONFIG_MAIN_STACK_SIZE=16384

CONFIG_EMLEARN=y
```

## src/main.c
```c
/*
 * Copyright (c) 2026 AIFoundry
 * SPDX-License-Identifier: Apache-2.0
 *
 * umode_emlearn_multi — single ELF, multi-program, single kernelLaunch.
 *
 * One Zephyr-U ELF runs FOUR different classifiers concurrently on four
 * different ET-SoC1 shires under a SINGLE kernelLaunch with
 * shire_mask = 0xF.  Each shire's lead hart picks its program based on
 * its shire-id (CSR 0xcd0 >> 6) and writes its 5 predictions into its
 * own 60-byte slot of a shared 240-byte host result buffer:
 *
 *     shire 0 → out[0..14]    iris-tree   (iris_tree_predict)
 *     shire 1 → out[15..29]   iris-rf     (iris_rf_predict)
 *     shire 2 → out[30..44]   wine-rf     (wine_rf_predict)
 *     shire 3 → out[45..59]   iris-tree   (re-run for symmetry)
 *
 * Result buffer layout (15 int32 per slot, only first 5 are predictions,
 * remainder is left at zero):
 *
 *   bytes [   0 ..  59) -> shire 0
 *   bytes [  60 .. 119) -> shire 1
 *   bytes [ 120 .. 179) -> shire 2
 *   bytes [ 180 .. 239) -> shire 3
 *
 * Per-shire stack carving is done by entry.S when
 * CONFIG_AIFOUNDRY_PER_SHIRE_STACK=y (set in this sample's prj.conf):
 * each shire gets its own 4096-byte slice of z_main_stack so the four
 * mains do not race on stack writes.  As a fallback, main() also
 * dispatches by shire-id from C — that path is what runs if the entry.S
 * patch is absent (e.g. on an earlier branch).
 */

#include <stdint.h>
#include <stddef.h>

#include <zephyr/aifoundry/runtime.h>

#include "test_vectors_gen.h"
#include "iris_tree.h"
#include "iris_rf.h"
#include "wine_rf.h"

#define SLOT_BYTES   60
#define N_SLOTS      4
#define BUF_BYTES    (SLOT_BYTES * N_SLOTS)
#define SLOT_INTS    (SLOT_BYTES / sizeof(int32_t))   /* 15 */

static inline unsigned int my_shire_id(void)
{
	uint64_t v;
	__asm__ volatile("csrr %0, 0xcd0" : "=r"(v));
	return (unsigned int)((v >> 6) & 0x1F);
}

static int32_t *my_result_slot(void)
{
	void *args = aifoundry_kernel_args();
	if (args == NULL) {
		return NULL;
	}
	uint64_t out_dev = *(volatile uint64_t *)args;
	if (out_dev == 0) {
		return NULL;
	}
	int32_t *base = (int32_t *)(uintptr_t)out_dev;
	return &base[my_shire_id() * SLOT_INTS];
}

/* Shared helper for main_a / main_d (both run iris_tree on the same 5
 * vectors).  Splitting the per-shire entry points keeps the C-level
 * dispatcher in main() trivial and lets the linker/optimizer share or
 * inline as it sees fit. */
static void run_iris_tree(int32_t *out)
{
	for (unsigned i = 0; i < IRIS_N_VECTORS; i++) {
		out[i] = iris_tree_predict(iris_test_vectors[i],
					   IRIS_N_FEATURES);
	}
}

void main_a(void)
{
	aifoundry_log("multi: shire 0 (iris-tree) start\n");
	int32_t *out = my_result_slot();
	if (out) {
		run_iris_tree(out);
		aifoundry_log("multi: shire 0 (iris-tree) preds %d %d %d %d %d\n",
			      (int)out[0], (int)out[1], (int)out[2],
			      (int)out[3], (int)out[4]);
	}
}

void main_b(void)
{
	aifoundry_log("multi: shire 1 (iris-rf) start\n");
	int32_t *out = my_result_slot();
	if (out) {
		for (unsigned i = 0; i < IRIS_N_VECTORS; i++) {
			out[i] = iris_rf_predict(iris_test_vectors[i],
						 IRIS_N_FEATURES);
		}
		aifoundry_log("multi: shire 1 (iris-rf) preds %d %d %d %d %d\n",
			      (int)out[0], (int)out[1], (int)out[2],
			      (int)out[3], (int)out[4]);
	}
}

void main_c(void)
{
	aifoundry_log("multi: shire 2 (wine-rf) start\n");
	int32_t *out = my_result_slot();
	if (out) {
		for (unsigned i = 0; i < WINE_N_VECTORS; i++) {
			out[i] = wine_rf_predict(wine_test_vectors[i],
						 WINE_N_FEATURES);
		}
		aifoundry_log("multi: shire 2 (wine-rf) preds %d %d %d %d %d\n",
			      (int)out[0], (int)out[1], (int)out[2],
			      (int)out[3], (int)out[4]);
	}
}

void main_d(void)
{
	aifoundry_log("multi: shire 3 (iris-tree-2) start\n");
	int32_t *out = my_result_slot();
	if (out) {
		run_iris_tree(out);
		aifoundry_log("multi: shire 3 (iris-tree-2) preds %d %d %d %d %d\n",
			      (int)out[0], (int)out[1], (int)out[2],
			      (int)out[3], (int)out[4]);
	}
}

/*
 * C-level dispatcher.  In this POC entry.S only sets up the per-shire
 * stack and still calls into the standard z_prep_c/main() path — there
 * is no asm-level jump table.  We dispatch on shire-id here.  This also
 * means the sample runs (with shared stack) even if entry.S has not
 * been patched yet, which is useful as a regression check.
 */
int main(void)
{
	switch (my_shire_id()) {
	case 0: main_a(); break;
	case 1: main_b(); break;
	case 2: main_c(); break;
	case 3: main_d(); break;
	default:
		aifoundry_log("multi: shire %u (no program assigned)\n",
			      my_shire_id());
		break;
	}
	aifoundry_kernel_exit(0);
}
```

## src/iris_rf.h
```c
    // !!! This file is generated using emlearn !!!

    #include <stdint.h>
    

static inline int32_t iris_rf_tree_0(const float *features, int32_t features_length) {
          if (features[3] < 0.750000f) {
              return 0;
          } else {
              if (features[2] < 4.850000f) {
                  if (features[3] < 1.650000f) {
                      return 1;
                  } else {
                      if (features[1] < 3.000000f) {
                          return 2;
                      } else {
                          return 1;
                      }
                  }
              } else {
                  if (features[0] < 6.600000f) {
                      return 2;
                  } else {
                      if (features[2] < 5.200000f) {
                          return 1;
                      } else {
                          return 2;
                      }
                  }
              }
          }
        }
        

static inline int32_t iris_rf_tree_1(const float *features, int32_t features_length) {
          if (features[3] < 0.800000f) {
              return 0;
          } else {
              if (features[3] < 1.750000f) {
                  if (features[2] < 4.950000f) {
                      return 1;
                  } else {
                      if (features[2] < 5.450000f) {
                          return 1;
                      } else {
                          return 2;
                      }
                  }
              } else {
                  if (features[3] < 1.900000f) {
                      if (features[2] < 4.850000f) {
                          return 2;
                      } else {
                          return 2;
                      }
                  } else {
                      return 2;
                  }
              }
          }
        }
        

static inline int32_t iris_rf_tree_2(const float *features, int32_t features_length) {
          if (features[0] < 5.550000f) {
              if (features[3] < 0.800000f) {
                  return 0;
              } else {
                  if (features[3] < 1.600000f) {
                      return 1;
                  } else {
                      return 2;
                  }
              }
          } else {
              if (features[3] < 1.550000f) {
                  if (features[3] < 0.750000f) {
                      return 0;
                  } else {
                      if (features[2] < 5.000000f) {
                          return 1;
                      } else {
                          return 2;
                      }
                  }
              } else {
                  if (features[2] < 4.650000f) {
                      return 1;
                  } else {
                      if (features[3] < 1.700000f) {
                          return 2;
                      } else {
                          return 2;
                      }
                  }
              }
          }
        }
        

static inline int32_t iris_rf_tree_3(const float *features, int32_t features_length) {
          if (features[0] < 5.450000f) {
              if (features[1] < 2.800000f) {
                  if (features[1] < 2.450000f) {
                      return 1;
                  } else {
                      if (features[0] < 5.000000f) {
                          return 2;
                      } else {
                          return 1;
                      }
                  }
              } else {
                  return 0;
              }
          } else {
              if (features[0] < 6.250000f) {
                  if (features[3] < 1.700000f) {
                      if (features[3] < 0.600000f) {
                          return 0;
                      } else {
                          return 1;
                      }
                  } else {
                      return 2;
                  }
              } else {
                  if (features[3] < 1.650000f) {
                      return 1;
                  } else {
                      return 2;
                  }
              }
          }
        }
        

static inline int32_t iris_rf_tree_4(const float *features, int32_t features_length) {
          if (features[3] < 0.700000f) {
              return 0;
          } else {
              if (features[3] < 1.750000f) {
                  if (features[2] < 5.050000f) {
                      if (features[2] < 4.950000f) {
                          return 1;
                      } else {
                          return 1;
                      }
                  } else {
                      if (features[3] < 1.550000f) {
                          return 2;
                      } else {
                          return 1;
                      }
                  }
              } else {
                  return 2;
              }
          }
        }
        

static inline int32_t iris_rf_tree_5(const float *features, int32_t features_length) {
          if (features[3] < 0.800000f) {
              return 0;
          } else {
              if (features[2] < 4.950000f) {
                  if (features[0] < 4.950000f) {
                      if (features[3] < 1.350000f) {
                          return 1;
                      } else {
                          return 2;
                      }
                  } else {
                      if (features[2] < 4.750000f) {
                          return 1;
                      } else {
                          return 1;
                      }
                  }
              } else {
                  return 2;
              }
          }
        }
        

static inline int32_t iris_rf_tree_6(const float *features, int32_t features_length) {
          if (features[3] < 0.700000f) {
              return 0;
          } else {
              if (features[2] < 4.750000f) {
                  if (features[0] < 4.950000f) {
                      return 2;
                  } else {
                      return 1;
                  }
              } else {
                  if (features[2] < 5.150000f) {
                      if (features[0] < 6.600000f) {
                          return 2;
                      } else {
                          return 1;
                      }
                  } else {
                      return 2;
                  }
              }
          }
        }
        

static inline int32_t iris_rf_tree_7(const float *features, int32_t features_length) {
          if (features[2] < 2.600000f) {
              return 0;
          } else {
              if (features[2] < 4.750000f) {
                  return 1;
              } else {
                  if (features[2] < 5.150000f) {
                      if (features[3] < 1.750000f) {
                          return 1;
                      } else {
                          return 2;
                      }
                  } else {
                      return 2;
                  }
              }
          }
        }
        

static inline int32_t iris_rf_tree_8(const float *features, int32_t features_length) {
          if (features[3] < 0.700000f) {
              return 0;
          } else {
              if (features[0] < 6.250000f) {
                  if (features[2] < 4.800000f) {
                      if (features[0] < 4.950000f) {
                          return 2;
                      } else {
                          return 1;
                      }
                  } else {
                      if (features[1] < 2.650000f) {
                          return 2;
                      } else {
                          return 2;
                      }
                  }
              } else {
                  if (features[2] < 5.050000f) {
                      if (features[0] < 6.350000f) {
                          return 1;
                      } else {
                          return 1;
                      }
                  } else {
                      return 2;
                  }
              }
          }
        }
        

static inline int32_t iris_rf_tree_9(const float *features, int32_t features_length) {
          if (features[2] < 2.600000f) {
              return 0;
          } else {
              if (features[2] < 4.950000f) {
                  if (features[0] < 5.950000f) {
                      return 1;
                  } else {
                      if (features[3] < 1.650000f) {
                          return 1;
                      } else {
                          return 2;
                      }
                  }
              } else {
                  if (features[0] < 6.600000f) {
                      return 2;
                  } else {
                      if (features[0] < 6.750000f) {
                          return 2;
                      } else {
                          return 2;
                      }
                  }
              }
          }
        }
        

int32_t iris_rf_predict(const float *features, int32_t features_length) {

        int32_t votes[3] = {0,};
        int32_t _class = -1;

        _class = iris_rf_tree_0(features, features_length); votes[_class] += 1;
    _class = iris_rf_tree_1(features, features_length); votes[_class] += 1;
    _class = iris_rf_tree_2(features, features_length); votes[_class] += 1;
    _class = iris_rf_tree_3(features, features_length); votes[_class] += 1;
    _class = iris_rf_tree_4(features, features_length); votes[_class] += 1;
    _class = iris_rf_tree_5(features, features_length); votes[_class] += 1;
    _class = iris_rf_tree_6(features, features_length); votes[_class] += 1;
    _class = iris_rf_tree_7(features, features_length); votes[_class] += 1;
    _class = iris_rf_tree_8(features, features_length); votes[_class] += 1;
    _class = iris_rf_tree_9(features, features_length); votes[_class] += 1;
    
        int32_t most_voted_class = -1;
        int32_t most_voted_votes = 0;
        for (int32_t i=0; i<3; i++) {

            if (votes[i] > most_voted_votes) {
                most_voted_class = i;
                most_voted_votes = votes[i];
            }
        }
        return most_voted_class;
    }
    

int iris_rf_predict_proba(const float *features, int32_t features_length, float *out, int out_length) {

        int32_t _class = -1;

        for (int i=0; i<out_length; i++) {
            out[i] = 0.0f;
        }

        _class = iris_rf_tree_0(features, features_length); out[_class] += 1.0f;
    _class = iris_rf_tree_1(features, features_length); out[_class] += 1.0f;
    _class = iris_rf_tree_2(features, features_length); out[_class] += 1.0f;
    _class = iris_rf_tree_3(features, features_length); out[_class] += 1.0f;
    _class = iris_rf_tree_4(features, features_length); out[_class] += 1.0f;
    _class = iris_rf_tree_5(features, features_length); out[_class] += 1.0f;
    _class = iris_rf_tree_6(features, features_length); out[_class] += 1.0f;
    _class = iris_rf_tree_7(features, features_length); out[_class] += 1.0f;
    _class = iris_rf_tree_8(features, features_length); out[_class] += 1.0f;
    _class = iris_rf_tree_9(features, features_length); out[_class] += 1.0f;
    
        // compute mean
        for (int i=0; i<out_length; i++) {
            out[i] = out[i] / 10;
        }
        return 0;
    }
    
```

## src/iris_tree.h
```c
    // !!! This file is generated using emlearn !!!

    #include <stdint.h>
    

static inline int32_t iris_tree_tree_0(const float *features, int32_t features_length) {
          if (features[3] < 0.800000f) {
              return 0;
          } else {
              if (features[3] < 1.750000f) {
                  if (features[2] < 4.950000f) {
                      if (features[3] < 1.650000f) {
                          return 1;
                      } else {
                          return 2;
                      }
                  } else {
                      if (features[3] < 1.550000f) {
                          return 2;
                      } else {
                          return 1;
                      }
                  }
              } else {
                  if (features[2] < 4.850000f) {
                      if (features[0] < 5.950000f) {
                          return 1;
                      } else {
                          return 2;
                      }
                  } else {
                      return 2;
                  }
              }
          }
        }
        

int32_t iris_tree_predict(const float *features, int32_t features_length) {

        int32_t votes[3] = {0,};
        int32_t _class = -1;

        _class = iris_tree_tree_0(features, features_length); votes[_class] += 1;
    
        int32_t most_voted_class = -1;
        int32_t most_voted_votes = 0;
        for (int32_t i=0; i<3; i++) {

            if (votes[i] > most_voted_votes) {
                most_voted_class = i;
                most_voted_votes = votes[i];
            }
        }
        return most_voted_class;
    }
    

int iris_tree_predict_proba(const float *features, int32_t features_length, float *out, int out_length) {

        int32_t _class = -1;

        for (int i=0; i<out_length; i++) {
            out[i] = 0.0f;
        }

        _class = iris_tree_tree_0(features, features_length); out[_class] += 1.0f;
    
        // compute mean
        for (int i=0; i<out_length; i++) {
            out[i] = out[i] / 1;
        }
        return 0;
    }
    
```

## src/test_vectors_gen.h
```c
/* Auto-generated from gen_classifiers.py — do not edit. */
#ifndef TEST_VECTORS_GEN_H
#define TEST_VECTORS_GEN_H

/* Iris: 4 features = sepal_len, sepal_w, petal_len, petal_w (cm) */
#define IRIS_N_FEATURES 4
#define IRIS_N_VECTORS  5
static const float iris_test_vectors[IRIS_N_VECTORS][IRIS_N_FEATURES] = {
    { 5.10f, 3.50f, 1.40f, 0.20f },  /* class 0 (setosa) */
    { 7.00f, 3.20f, 4.70f, 1.40f },  /* class 1 (versicolor) */
    { 6.30f, 3.30f, 6.00f, 2.50f },  /* class 2 (virginica) */
    { 5.00f, 3.00f, 1.60f, 0.20f },  /* class 0 (setosa) */
    { 6.60f, 3.00f, 4.40f, 1.40f },  /* class 1 (versicolor) */
};
static const int iris_expected[IRIS_N_VECTORS] = { 0, 1, 2, 0, 1 };

/* Wine: 13 features, 3 classes (cultivars) */
#define WINE_N_FEATURES 13
#define WINE_N_VECTORS  5
static const float wine_test_vectors[WINE_N_VECTORS][WINE_N_FEATURES] = {
    { 14.2300f, 1.7100f, 2.4300f, 15.6000f, 127.0000f, 2.8000f, 3.0600f, 0.2800f, 2.2900f, 5.6400f, 1.0400f, 3.9200f, 1065.0000f },  /* class 0 */
    { 12.3300f, 1.1000f, 2.2800f, 16.0000f, 101.0000f, 2.0500f, 1.0900f, 0.6300f, 0.4100f, 3.2700f, 1.2500f, 1.6700f, 680.0000f },  /* class 1 */
    { 12.8600f, 1.3500f, 2.3200f, 18.0000f, 122.0000f, 1.5100f, 1.2500f, 0.2100f, 0.9400f, 4.1000f, 0.7600f, 1.2900f, 630.0000f },  /* class 2 */
    { 13.5600f, 1.7100f, 2.3100f, 16.2000f, 117.0000f, 3.1500f, 3.2900f, 0.3400f, 2.3400f, 6.1300f, 0.9500f, 3.3800f, 795.0000f },  /* class 0 */
    { 12.0800f, 2.0800f, 1.7000f, 17.5000f, 97.0000f, 2.2300f, 2.1700f, 0.2600f, 1.4000f, 3.3000f, 1.2700f, 2.9600f, 710.0000f },  /* class 1 */
};
static const int wine_expected[WINE_N_VECTORS] = { 0, 1, 2, 0, 1 };

#endif
```

## src/wine_rf.h
```c
    // !!! This file is generated using emlearn !!!

    #include <stdint.h>
    

static inline int32_t wine_rf_tree_0(const float *features, int32_t features_length) {
          if (features[9] < 3.460000f) {
              return 1;
          } else {
              if (features[8] < 1.270000f) {
                  if (features[10] < 0.970000f) {
                      if (features[0] < 13.995000f) {
                          return 2;
                      } else {
                          return 0;
                      }
                  } else {
                      if (features[11] < 3.530000f) {
                          return 1;
                      } else {
                          return 0;
                      }
                  }
              } else {
                  if (features[11] < 2.130000f) {
                      return 2;
                  } else {
                      if (features[6] < 2.200000f) {
                          return 1;
                      } else {
                          return 0;
                      }
                  }
              }
          }
        }
        

static inline int32_t wine_rf_tree_1(const float *features, int32_t features_length) {
          if (features[6] < 1.400000f) {
              if (features[0] < 12.410000f) {
                  if (features[9] < 3.560000f) {
                      return 1;
                  } else {
                      return 2;
                  }
              } else {
                  if (features[3] < 17.750000f) {
                      return 1;
                  } else {
                      return 2;
                  }
              }
          } else {
              if (features[12] < 755.000000f) {
                  if (features[4] < 121.000000f) {
                      if (features[10] < 0.830000f) {
                          return 1;
                      } else {
                          return 1;
                      }
                  } else {
                      if (features[2] < 2.285000f) {
                          return 1;
                      } else {
                          return 2;
                      }
                  }
              } else {
                  if (features[0] < 12.700000f) {
                      return 1;
                  } else {
                      if (features[10] < 1.280000f) {
                          return 0;
                      } else {
                          return 1;
                      }
                  }
              }
          }
        }
        

static inline int32_t wine_rf_tree_2(const float *features, int32_t features_length) {
          if (features[6] < 1.425000f) {
              if (features[3] < 17.650000f) {
                  return 1;
              } else {
                  return 2;
              }
          } else {
              if (features[12] < 724.500000f) {
                  if (features[0] < 13.175000f) {
                      return 1;
                  } else {
                      if (features[7] < 0.295000f) {
                          return 1;
                      } else {
                          return 0;
                      }
                  }
              } else {
                  if (features[7] < 0.150000f) {
                      return 1;
                  } else {
                      if (features[8] < 3.120000f) {
                          return 0;
                      } else {
                          return 1;
                      }
                  }
              }
          }
        }
        

static inline int32_t wine_rf_tree_3(const float *features, int32_t features_length) {
          if (features[12] < 755.000000f) {
              if (features[8] < 1.295000f) {
                  if (features[10] < 0.895000f) {
                      return 2;
                  } else {
                      if (features[9] < 4.100000f) {
                          return 1;
                      } else {
                          return 2;
                      }
                  }
              } else {
                  if (features[0] < 13.080000f) {
                      return 1;
                  } else {
                      if (features[7] < 0.410000f) {
                          return 0;
                      } else {
                          return 2;
                      }
                  }
              }
          } else {
              if (features[6] < 2.300000f) {
                  if (features[4] < 141.000000f) {
                      return 2;
                  } else {
                      return 1;
                  }
              } else {
                  if (features[10] < 1.280000f) {
                      return 0;
                  } else {
                      return 1;
                  }
              }
          }
        }
        

static inline int32_t wine_rf_tree_4(const float *features, int32_t features_length) {
          if (features[6] < 2.350000f) {
              if (features[6] < 0.955000f) {
                  if (features[8] < 0.485000f) {
                      return 1;
                  } else {
                      return 2;
                  }
              } else {
                  if (features[11] < 1.530000f) {
                      return 2;
                  } else {
                      if (features[0] < 14.005000f) {
                          return 1;
                      } else {
                          return 2;
                      }
                  }
              }
          } else {
              if (features[4] < 88.500000f) {
                  return 1;
              } else {
                  if (features[9] < 3.435000f) {
                      return 1;
                  } else {
                      if (features[1] < 1.280000f) {
                          return 1;
                      } else {
                          return 0;
                      }
                  }
              }
          }
        }
        

static inline int32_t wine_rf_tree_5(const float *features, int32_t features_length) {
          if (features[9] < 3.820000f) {
              if (features[12] < 1010.000000f) {
                  if (features[6] < 2.595000f) {
                      return 1;
                  } else {
                      if (features[12] < 762.500000f) {
                          return 1;
                      } else {
                          return 0;
                      }
                  }
              } else {
                  return 0;
              }
          } else {
              if (features[11] < 2.295000f) {
                  return 2;
              } else {
                  if (features[2] < 2.205000f) {
                      if (features[12] < 799.500000f) {
                          return 1;
                      } else {
                          return 0;
                      }
                  } else {
                      if (features[3] < 21.250000f) {
                          return 0;
                      } else {
                          return 1;
                      }
                  }
              }
          }
        }
        

static inline int32_t wine_rf_tree_6(const float *features, int32_t features_length) {
          if (features[4] < 88.500000f) {
              if (features[6] < 1.085000f) {
                  if (features[7] < 0.340000f) {
                      return 1;
                  } else {
                      return 2;
                  }
              } else {
                  return 1;
              }
          } else {
              if (features[6] < 2.300000f) {
                  if (features[6] < 1.570000f) {
                      if (features[6] < 0.975000f) {
                          return 2;
                      } else {
                          return 2;
                      }
                  } else {
                      return 1;
                  }
              } else {
                  if (features[3] < 22.750000f) {
                      if (features[8] < 3.270000f) {
                          return 0;
                      } else {
                          return 1;
                      }
                  } else {
                      if (features[11] < 3.350000f) {
                          return 0;
                      } else {
                          return 1;
                      }
                  }
              }
          }
        }
        

static inline int32_t wine_rf_tree_7(const float *features, int32_t features_length) {
          if (features[12] < 726.500000f) {
              if (features[8] < 1.285000f) {
                  if (features[10] < 0.885000f) {
                      if (features[3] < 16.750000f) {
                          return 1;
                      } else {
                          return 2;
                      }
                  } else {
                      if (features[4] < 105.000000f) {
                          return 1;
                      } else {
                          return 1;
                      }
                  }
              } else {
                  if (features[10] < 0.650000f) {
                      return 2;
                  } else {
                      if (features[0] < 13.175000f) {
                          return 1;
                      } else {
                          return 0;
                      }
                  }
              }
          } else {
              if (features[6] < 2.320000f) {
                  if (features[8] < 2.410000f) {
                      return 2;
                  } else {
                      return 1;
                  }
              } else {
                  if (features[3] < 27.500000f) {
                      return 0;
                  } else {
                      return 1;
                  }
              }
          }
        }
        

static inline int32_t wine_rf_tree_8(const float *features, int32_t features_length) {
          if (features[5] < 2.050000f) {
              if (features[8] < 1.585000f) {
                  if (features[9] < 3.825000f) {
                      return 1;
                  } else {
                      return 2;
                  }
              } else {
                  if (features[6] < 1.040000f) {
                      return 2;
                  } else {
                      return 1;
                  }
              }
          } else {
              if (features[3] < 17.350000f) {
                  if (features[0] < 13.155000f) {
                      if (features[1] < 1.590000f) {
                          return 1;
                      } else {
                          return 0;
                      }
                  } else {
                      return 0;
                  }
              } else {
                  if (features[6] < 3.120000f) {
                      if (features[6] < 2.340000f) {
                          return 1;
                      } else {
                          return 1;
                      }
                  } else {
                      return 0;
                  }
              }
          }
        }
        

static inline int32_t wine_rf_tree_9(const float *features, int32_t features_length) {
          if (features[12] < 755.000000f) {
              if (features[8] < 1.285000f) {
                  if (features[1] < 1.880000f) {
                      if (features[7] < 0.245000f) {
                          return 2;
                      } else {
                          return 1;
                      }
                  } else {
                      if (features[9] < 3.525000f) {
                          return 1;
                      } else {
                          return 2;
                      }
                  }
              } else {
                  if (features[4] < 88.500000f) {
                      return 1;
                  } else {
                      if (features[9] < 5.850000f) {
                          return 1;
                      } else {
                          return 2;
                      }
                  }
              }
          } else {
              if (features[5] < 2.125000f) {
                  if (features[1] < 2.085000f) {
                      return 1;
                  } else {
                      return 2;
                  }
              } else {
                  if (features[3] < 25.250000f) {
                      if (features[8] < 3.120000f) {
                          return 0;
                      } else {
                          return 1;
                      }
                  } else {
                      return 1;
                  }
              }
          }
        }
        

int32_t wine_rf_predict(const float *features, int32_t features_length) {

        int32_t votes[3] = {0,};
        int32_t _class = -1;

        _class = wine_rf_tree_0(features, features_length); votes[_class] += 1;
    _class = wine_rf_tree_1(features, features_length); votes[_class] += 1;
    _class = wine_rf_tree_2(features, features_length); votes[_class] += 1;
    _class = wine_rf_tree_3(features, features_length); votes[_class] += 1;
    _class = wine_rf_tree_4(features, features_length); votes[_class] += 1;
    _class = wine_rf_tree_5(features, features_length); votes[_class] += 1;
    _class = wine_rf_tree_6(features, features_length); votes[_class] += 1;
    _class = wine_rf_tree_7(features, features_length); votes[_class] += 1;
    _class = wine_rf_tree_8(features, features_length); votes[_class] += 1;
    _class = wine_rf_tree_9(features, features_length); votes[_class] += 1;
    
        int32_t most_voted_class = -1;
        int32_t most_voted_votes = 0;
        for (int32_t i=0; i<3; i++) {

            if (votes[i] > most_voted_votes) {
                most_voted_class = i;
                most_voted_votes = votes[i];
            }
        }
        return most_voted_class;
    }
    

int wine_rf_predict_proba(const float *features, int32_t features_length, float *out, int out_length) {

        int32_t _class = -1;

        for (int i=0; i<out_length; i++) {
            out[i] = 0.0f;
        }

        _class = wine_rf_tree_0(features, features_length); out[_class] += 1.0f;
    _class = wine_rf_tree_1(features, features_length); out[_class] += 1.0f;
    _class = wine_rf_tree_2(features, features_length); out[_class] += 1.0f;
    _class = wine_rf_tree_3(features, features_length); out[_class] += 1.0f;
    _class = wine_rf_tree_4(features, features_length); out[_class] += 1.0f;
    _class = wine_rf_tree_5(features, features_length); out[_class] += 1.0f;
    _class = wine_rf_tree_6(features, features_length); out[_class] += 1.0f;
    _class = wine_rf_tree_7(features, features_length); out[_class] += 1.0f;
    _class = wine_rf_tree_8(features, features_length); out[_class] += 1.0f;
    _class = wine_rf_tree_9(features, features_length); out[_class] += 1.0f;
    
        // compute mean
        for (int i=0; i<out_length; i++) {
            out[i] = out[i] / 10;
        }
        return 0;
    }
    
```
