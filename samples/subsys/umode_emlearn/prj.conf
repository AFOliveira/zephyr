## CMakeLists.txt
```
# Copyright (c) 2026 AIFoundry
# SPDX-License-Identifier: Apache-2.0
#
# emlearn-style inference demo on Zephyr.  Runs generated decision-tree
# classifiers over canned test vectors and exits via the cm-umode kernel
# return syscall on ET-SoC1.

cmake_minimum_required(VERSION 3.20.0)

find_package(Zephyr REQUIRED HINTS $ENV{ZEPHYR_BASE})
project(umode_emlearn)

target_sources(app PRIVATE
    src/main.c
)
# The generated classifiers are header-only.
target_include_directories(app PRIVATE src)

zephyr_ld_options(-Wl,--emit-relocs)
```

## sample.yaml
```
sample:
  name: emlearn-style inference on Zephyr
  description: Pure-compute generated decision tree classifiers.
tests:
  sample.subsys.umode_emlearn:
    platform_allow:
      - etsoc1_minion_umode
      - erbium_minion
    tags: riscv umode emlearn ml
    harness: console
    harness_config:
      type: one_line
      regex:
        - "emlearn-demo: done"
```

## prj.conf
```kconfig
# Copyright (c) 2026 AIFoundry
# SPDX-License-Identifier: Apache-2.0
#
# Common settings. Board-specific configuration picks between U-mode
# ET-SoC1 and native M-mode Erbium.

CONFIG_MULTITHREADING=n
CONFIG_BOOT_BANNER=n
CONFIG_MAIN_STACK_SIZE=4096
CONFIG_COMMON_LIBC_MALLOC=n
```

## boards/erbium_minion.conf
```kconfig
# Copyright (c) 2026 AIFoundry
# SPDX-License-Identifier: Apache-2.0
#
# Erbium: Zephyr-M runs natively at M-mode with a real Shakti UART
# console.  No U-mode trickery, no MachineMinion.  Output goes to
# the UART directly; "exit" is just main() returning.

# RISCV_RUN_IN_UMODE stays at its default (n) here — Erbium board
# doesn't force it.  No override needed.
```

## boards/etsoc1_minion_umode.conf
```kconfig
# Copyright (c) 2026 AIFoundry
# SPDX-License-Identifier: Apache-2.0
#
# ET-SoC1: Zephyr runs in RISC-V U-mode under MachineMinion.
# Output goes to the __umode_printk_ring; real UART needs a syscall
# we deliberately don't use here.

CONFIG_RISCV_RUN_IN_UMODE=y
CONFIG_CONSOLE=n
CONFIG_SERIAL=n
```

## src/main.c
```c
/*
 * Copyright (c) 2026 AIFoundry
 * SPDX-License-Identifier: Apache-2.0
 *
 * emlearn demo — runs three sklearn-trained classifiers (DecisionTree
 * on iris, RandomForest on iris, RandomForest on wine) on canned test
 * vectors.
 *
 * On ET-SoC1 U-mode this uses Vidas' ET surface directly: et_printf()
 * for logs, cache_ops_priv_evict_whole_l1_l2() for host-visible writes,
 * and SYSCALL_RETURN_FROM_KERNEL for exit.
 */

#include <stdint.h>
#include <stddef.h>

#include <zephyr/kernel.h>

#if defined(CONFIG_RISCV_RUN_IN_UMODE)
#include <etsoc/common/utils.h>
#include <etsoc/isa/cacheops-umode.h>
#else
#include <zephyr/sys/printk.h>
#endif

#include "test_vectors_gen.h"
#include "iris_tree.h"
#include "iris_rf.h"
#include "wine_rf.h"

#if defined(CONFIG_RISCV_RUN_IN_UMODE)
extern void *cm_umode_kernel_args;

#define emlearn_log(...) et_printf(__VA_ARGS__)

static void emlearn_publish_results(const void *src, size_t size)
{
	void *args = cm_umode_kernel_args;

	if ((args == NULL) || (args == (void *)~(uintptr_t)0)) {
		return;
	}

	uint64_t out_dev = *(volatile uint64_t *)args;
	if (out_dev == 0U) {
		return;
	}

	const uint8_t *s = (const uint8_t *)src;
	volatile uint8_t *d = (volatile uint8_t *)(uintptr_t)out_dev;

	for (size_t i = 0; i < size; i++) {
		d[i] = s[i];
	}
}

__attribute__((noreturn))
static void emlearn_kernel_exit(int rc)
{
	int code = (rc == 0) ? KERNEL_RETURN_SUCCESS : KERNEL_RETURN_SELF_ABORT;

	(void)cache_ops_priv_evict_whole_l1_l2();
	(void)syscall(SYSCALL_RETURN_FROM_KERNEL, 0, code, 0);

	for (;;) {
		__asm__ volatile("nop");
	}
}
#else
#define emlearn_log(...) printk(__VA_ARGS__)

static void emlearn_publish_results(const void *src, size_t size)
{
	ARG_UNUSED(src);
	ARG_UNUSED(size);
}

static void emlearn_kernel_exit(int rc)
{
	ARG_UNUSED(rc);
}
#endif

int main(void)
{
	int32_t iris_tree_pred[IRIS_N_VECTORS];
	int32_t iris_rf_pred[IRIS_N_VECTORS];
	int32_t wine_rf_pred[WINE_N_VECTORS];

	ARG_UNUSED(iris_expected);
	ARG_UNUSED(wine_expected);

	emlearn_log("emlearn-demo: start\n");
	emlearn_log("emlearn-demo: iris (DecisionTree, 4 features, 5 vectors)\n");
	for (unsigned i = 0; i < IRIS_N_VECTORS; i++) {
		iris_tree_pred[i] = iris_tree_predict(iris_test_vectors[i],
						      IRIS_N_FEATURES);
		emlearn_log("  iris-tree[%u] -> %d\n",
			    i, (int)iris_tree_pred[i]);
	}

	emlearn_log("emlearn-demo: iris (RandomForest, 10 trees)\n");
	for (unsigned i = 0; i < IRIS_N_VECTORS; i++) {
		iris_rf_pred[i] = iris_rf_predict(iris_test_vectors[i],
						  IRIS_N_FEATURES);
		emlearn_log("  iris-rf[%u]   -> %d\n",
			    i, (int)iris_rf_pred[i]);
	}

	emlearn_log("emlearn-demo: wine (RandomForest, 10 trees, 13 features)\n");
	for (unsigned i = 0; i < WINE_N_VECTORS; i++) {
		wine_rf_pred[i] = wine_rf_predict(wine_test_vectors[i],
						  WINE_N_FEATURES);
		emlearn_log("  wine-rf[%u]   -> %d\n",
			    i, (int)wine_rf_pred[i]);
	}
	emlearn_log("emlearn-demo: done\n");

	/* Pack predictions into the host-allocated result buffer
	 * (silently no-op on M-mode where there's no host). */
	int32_t out_packed[IRIS_N_VECTORS * 2 + WINE_N_VECTORS];
	for (unsigned i = 0; i < IRIS_N_VECTORS; i++) {
		out_packed[i] = iris_tree_pred[i];
		out_packed[IRIS_N_VECTORS + i] = iris_rf_pred[i];
	}
	for (unsigned i = 0; i < WINE_N_VECTORS; i++) {
		out_packed[2 * IRIS_N_VECTORS + i] = wine_rf_pred[i];
	}
	emlearn_publish_results(out_packed, sizeof(out_packed));

	emlearn_kernel_exit(0);
}
```

## src/iris_classifier.c
```c
/*
 * Copyright (c) 2026 AIFoundry
 * SPDX-License-Identifier: Apache-2.0
 *
 * Hand-written decision tree classifier in the shape emlearn emits:
 *   - pure C, no heap, no floats (integer thresholds)
 *   - nested if/else over feature indices
 *   - each leaf returns the class label directly
 *
 * This is what `emlearn.convert(sklearn_tree).save(..., 'inline')`
 * would produce for a 3-feature iris-like tree.  The thresholds below
 * are illustrative, not fit to real data.
 */

#include "iris_classifier.h"

const char *const iris_class_names[IRIS_N_CLASSES] = {
	"setosa",
	"versicolor",
	"virginica",
};

int32_t iris_classify(const int32_t features[IRIS_N_FEATURES])
{
	/* features[0] = petal_length (mm)
	 * features[1] = petal_width  (mm)
	 * features[2] = sepal_length (mm)
	 */
	if (features[0] < 25) {
		/* Short petals — dominated by setosa. */
		return 0;
	}
	if (features[1] < 17) {
		if (features[0] < 50) {
			return 1; /* versicolor */
		}
		if (features[2] < 62) {
			return 1;
		}
		return 2;         /* virginica */
	}
	if (features[0] < 48) {
		if (features[1] < 16) {
			return 1;
		}
		return 2;
	}
	return 2;
}
```

## src/iris_classifier.h
```c
/*
 * Copyright (c) 2026 AIFoundry
 * SPDX-License-Identifier: Apache-2.0
 *
 * Shape of emlearn C output for a DecisionTreeClassifier.  emlearn
 * generates a `classify()` function like the one in iris_classifier.c:
 * nested if/else over integer features with constant-folded
 * thresholds.  Small, branch-predictable, no heap, no runtime deps.
 */

#ifndef IRIS_CLASSIFIER_H
#define IRIS_CLASSIFIER_H

#include <stdint.h>

#define IRIS_N_FEATURES 3
#define IRIS_N_CLASSES  3

/* Features are integer-scaled (e.g. millimetres) to stay away from
 * minimal libc's lack of %f.  Order: petal_length, petal_width,
 * sepal_length. */
int32_t iris_classify(const int32_t features[IRIS_N_FEATURES]);

/* Human-readable class names. */
extern const char *const iris_class_names[IRIS_N_CLASSES];

#endif /* IRIS_CLASSIFIER_H */
```

## src/iris_rf.h
```c
    // !!! This file is generated using emlearn !!!

    #include <stdint.h>


static inline int32_t iris_rf_tree_0(const float *features, int32_t features_length) {
          if (features[3] < 0.750000f) {
              return 0;
          } else {
              if (features[2] < 4.850000f) {
                  if (features[3] < 1.650000f) {
                      return 1;
                  } else {
                      if (features[1] < 3.000000f) {
                          return 2;
                      } else {
                          return 1;
                      }
                  }
              } else {
                  if (features[0] < 6.600000f) {
                      return 2;
                  } else {
                      if (features[2] < 5.200000f) {
                          return 1;
                      } else {
                          return 2;
                      }
                  }
              }
          }
        }


static inline int32_t iris_rf_tree_1(const float *features, int32_t features_length) {
          if (features[3] < 0.800000f) {
              return 0;
          } else {
              if (features[3] < 1.750000f) {
                  if (features[2] < 4.950000f) {
                      return 1;
                  } else {
                      if (features[2] < 5.450000f) {
                          return 1;
                      } else {
                          return 2;
                      }
                  }
              } else {
                  if (features[3] < 1.900000f) {
                      if (features[2] < 4.850000f) {
                          return 2;
                      } else {
                          return 2;
                      }
                  } else {
                      return 2;
                  }
              }
          }
        }


static inline int32_t iris_rf_tree_2(const float *features, int32_t features_length) {
          if (features[0] < 5.550000f) {
              if (features[3] < 0.800000f) {
                  return 0;
              } else {
                  if (features[3] < 1.600000f) {
                      return 1;
                  } else {
                      return 2;
                  }
              }
          } else {
              if (features[3] < 1.550000f) {
                  if (features[3] < 0.750000f) {
                      return 0;
                  } else {
                      if (features[2] < 5.000000f) {
                          return 1;
                      } else {
                          return 2;
                      }
                  }
              } else {
                  if (features[2] < 4.650000f) {
                      return 1;
                  } else {
                      if (features[3] < 1.700000f) {
                          return 2;
                      } else {
                          return 2;
                      }
                  }
              }
          }
        }


static inline int32_t iris_rf_tree_3(const float *features, int32_t features_length) {
          if (features[0] < 5.450000f) {
              if (features[1] < 2.800000f) {
                  if (features[1] < 2.450000f) {
                      return 1;
                  } else {
                      if (features[0] < 5.000000f) {
                          return 2;
                      } else {
                          return 1;
                      }
                  }
              } else {
                  return 0;
              }
          } else {
              if (features[0] < 6.250000f) {
                  if (features[3] < 1.700000f) {
                      if (features[3] < 0.600000f) {
                          return 0;
                      } else {
                          return 1;
                      }
                  } else {
                      return 2;
                  }
              } else {
                  if (features[3] < 1.650000f) {
                      return 1;
                  } else {
                      return 2;
                  }
              }
          }
        }


static inline int32_t iris_rf_tree_4(const float *features, int32_t features_length) {
          if (features[3] < 0.700000f) {
              return 0;
          } else {
              if (features[3] < 1.750000f) {
                  if (features[2] < 5.050000f) {
                      if (features[2] < 4.950000f) {
                          return 1;
                      } else {
                          return 1;
                      }
                  } else {
                      if (features[3] < 1.550000f) {
                          return 2;
                      } else {
                          return 1;
                      }
                  }
              } else {
                  return 2;
              }
          }
        }


static inline int32_t iris_rf_tree_5(const float *features, int32_t features_length) {
          if (features[3] < 0.800000f) {
              return 0;
          } else {
              if (features[2] < 4.950000f) {
                  if (features[0] < 4.950000f) {
                      if (features[3] < 1.350000f) {
                          return 1;
                      } else {
                          return 2;
                      }
                  } else {
                      if (features[2] < 4.750000f) {
                          return 1;
                      } else {
                          return 1;
                      }
                  }
              } else {
                  return 2;
              }
          }
        }


static inline int32_t iris_rf_tree_6(const float *features, int32_t features_length) {
          if (features[3] < 0.700000f) {
              return 0;
          } else {
              if (features[2] < 4.750000f) {
                  if (features[0] < 4.950000f) {
                      return 2;
                  } else {
                      return 1;
                  }
              } else {
                  if (features[2] < 5.150000f) {
                      if (features[0] < 6.600000f) {
                          return 2;
                      } else {
                          return 1;
                      }
                  } else {
                      return 2;
                  }
              }
          }
        }


static inline int32_t iris_rf_tree_7(const float *features, int32_t features_length) {
          if (features[2] < 2.600000f) {
              return 0;
          } else {
              if (features[2] < 4.750000f) {
                  return 1;
              } else {
                  if (features[2] < 5.150000f) {
                      if (features[3] < 1.750000f) {
                          return 1;
                      } else {
                          return 2;
                      }
                  } else {
                      return 2;
                  }
              }
          }
        }


static inline int32_t iris_rf_tree_8(const float *features, int32_t features_length) {
          if (features[3] < 0.700000f) {
              return 0;
          } else {
              if (features[0] < 6.250000f) {
                  if (features[2] < 4.800000f) {
                      if (features[0] < 4.950000f) {
                          return 2;
                      } else {
                          return 1;
                      }
                  } else {
                      if (features[1] < 2.650000f) {
                          return 2;
                      } else {
                          return 2;
                      }
                  }
              } else {
                  if (features[2] < 5.050000f) {
                      if (features[0] < 6.350000f) {
                          return 1;
                      } else {
                          return 1;
                      }
                  } else {
                      return 2;
                  }
              }
          }
        }


static inline int32_t iris_rf_tree_9(const float *features, int32_t features_length) {
          if (features[2] < 2.600000f) {
              return 0;
          } else {
              if (features[2] < 4.950000f) {
                  if (features[0] < 5.950000f) {
                      return 1;
                  } else {
                      if (features[3] < 1.650000f) {
                          return 1;
                      } else {
                          return 2;
                      }
                  }
              } else {
                  if (features[0] < 6.600000f) {
                      return 2;
                  } else {
                      if (features[0] < 6.750000f) {
                          return 2;
                      } else {
                          return 2;
                      }
                  }
              }
          }
        }


int32_t iris_rf_predict(const float *features, int32_t features_length) {

        int32_t votes[3] = {0,};
        int32_t _class = -1;

        _class = iris_rf_tree_0(features, features_length); votes[_class] += 1;
    _class = iris_rf_tree_1(features, features_length); votes[_class] += 1;
    _class = iris_rf_tree_2(features, features_length); votes[_class] += 1;
    _class = iris_rf_tree_3(features, features_length); votes[_class] += 1;
    _class = iris_rf_tree_4(features, features_length); votes[_class] += 1;
    _class = iris_rf_tree_5(features, features_length); votes[_class] += 1;
    _class = iris_rf_tree_6(features, features_length); votes[_class] += 1;
    _class = iris_rf_tree_7(features, features_length); votes[_class] += 1;
    _class = iris_rf_tree_8(features, features_length); votes[_class] += 1;
    _class = iris_rf_tree_9(features, features_length); votes[_class] += 1;

        int32_t most_voted_class = -1;
        int32_t most_voted_votes = 0;
        for (int32_t i=0; i<3; i++) {

            if (votes[i] > most_voted_votes) {
                most_voted_class = i;
                most_voted_votes = votes[i];
            }
        }
        return most_voted_class;
    }


int iris_rf_predict_proba(const float *features, int32_t features_length, float *out, int out_length) {

        int32_t _class = -1;

        for (int i=0; i<out_length; i++) {
            out[i] = 0.0f;
        }

        _class = iris_rf_tree_0(features, features_length); out[_class] += 1.0f;
    _class = iris_rf_tree_1(features, features_length); out[_class] += 1.0f;
    _class = iris_rf_tree_2(features, features_length); out[_class] += 1.0f;
    _class = iris_rf_tree_3(features, features_length); out[_class] += 1.0f;
    _class = iris_rf_tree_4(features, features_length); out[_class] += 1.0f;
    _class = iris_rf_tree_5(features, features_length); out[_class] += 1.0f;
    _class = iris_rf_tree_6(features, features_length); out[_class] += 1.0f;
    _class = iris_rf_tree_7(features, features_length); out[_class] += 1.0f;
    _class = iris_rf_tree_8(features, features_length); out[_class] += 1.0f;
    _class = iris_rf_tree_9(features, features_length); out[_class] += 1.0f;

        // compute mean
        for (int i=0; i<out_length; i++) {
            out[i] = out[i] / 10;
        }
        return 0;
    }
```

## src/iris_tree.h
```c
    // !!! This file is generated using emlearn !!!

    #include <stdint.h>


static inline int32_t iris_tree_tree_0(const float *features, int32_t features_length) {
          if (features[3] < 0.800000f) {
              return 0;
          } else {
              if (features[3] < 1.750000f) {
                  if (features[2] < 4.950000f) {
                      if (features[3] < 1.650000f) {
                          return 1;
                      } else {
                          return 2;
                      }
                  } else {
                      if (features[3] < 1.550000f) {
                          return 2;
                      } else {
                          return 1;
                      }
                  }
              } else {
                  if (features[2] < 4.850000f) {
                      if (features[0] < 5.950000f) {
                          return 1;
                      } else {
                          return 2;
                      }
                  } else {
                      return 2;
                  }
              }
          }
        }


int32_t iris_tree_predict(const float *features, int32_t features_length) {

        int32_t votes[3] = {0,};
        int32_t _class = -1;

        _class = iris_tree_tree_0(features, features_length); votes[_class] += 1;

        int32_t most_voted_class = -1;
        int32_t most_voted_votes = 0;
        for (int32_t i=0; i<3; i++) {

            if (votes[i] > most_voted_votes) {
                most_voted_class = i;
                most_voted_votes = votes[i];
            }
        }
        return most_voted_class;
    }


int iris_tree_predict_proba(const float *features, int32_t features_length, float *out, int out_length) {

        int32_t _class = -1;

        for (int i=0; i<out_length; i++) {
            out[i] = 0.0f;
        }

        _class = iris_tree_tree_0(features, features_length); out[_class] += 1.0f;

        // compute mean
        for (int i=0; i<out_length; i++) {
            out[i] = out[i] / 1;
        }
        return 0;
    }
```

## src/wine_rf.h
```c
    // !!! This file is generated using emlearn !!!

    #include <stdint.h>


static inline int32_t wine_rf_tree_0(const float *features, int32_t features_length) {
          if (features[9] < 3.460000f) {
              return 1;
          } else {
              if (features[8] < 1.270000f) {
                  if (features[10] < 0.970000f) {
                      if (features[0] < 13.995000f) {
                          return 2;
                      } else {
                          return 0;
                      }
                  } else {
                      if (features[11] < 3.530000f) {
                          return 1;
                      } else {
                          return 0;
                      }
                  }
              } else {
                  if (features[11] < 2.130000f) {
                      return 2;
                  } else {
                      if (features[6] < 2.200000f) {
                          return 1;
                      } else {
                          return 0;
                      }
                  }
              }
          }
        }


static inline int32_t wine_rf_tree_1(const float *features, int32_t features_length) {
          if (features[6] < 1.400000f) {
              if (features[0] < 12.410000f) {
                  if (features[9] < 3.560000f) {
                      return 1;
                  } else {
                      return 2;
                  }
              } else {
                  if (features[3] < 17.750000f) {
                      return 1;
                  } else {
                      return 2;
                  }
              }
          } else {
              if (features[12] < 755.000000f) {
                  if (features[4] < 121.000000f) {
                      if (features[10] < 0.830000f) {
                          return 1;
                      } else {
                          return 1;
                      }
                  } else {
                      if (features[2] < 2.285000f) {
                          return 1;
                      } else {
                          return 2;
                      }
                  }
              } else {
                  if (features[0] < 12.700000f) {
                      return 1;
                  } else {
                      if (features[10] < 1.280000f) {
                          return 0;
                      } else {
                          return 1;
                      }
                  }
              }
          }
        }


static inline int32_t wine_rf_tree_2(const float *features, int32_t features_length) {
          if (features[6] < 1.425000f) {
              if (features[3] < 17.650000f) {
                  return 1;
              } else {
                  return 2;
              }
          } else {
              if (features[12] < 724.500000f) {
                  if (features[0] < 13.175000f) {
                      return 1;
                  } else {
                      if (features[7] < 0.295000f) {
                          return 1;
                      } else {
                          return 0;
                      }
                  }
              } else {
                  if (features[7] < 0.150000f) {
                      return 1;
                  } else {
                      if (features[8] < 3.120000f) {
                          return 0;
                      } else {
                          return 1;
                      }
                  }
              }
          }
        }


static inline int32_t wine_rf_tree_3(const float *features, int32_t features_length) {
          if (features[12] < 755.000000f) {
              if (features[8] < 1.295000f) {
                  if (features[10] < 0.895000f) {
                      return 2;
                  } else {
                      if (features[9] < 4.100000f) {
                          return 1;
                      } else {
                          return 2;
                      }
                  }
              } else {
                  if (features[0] < 13.080000f) {
                      return 1;
                  } else {
                      if (features[7] < 0.410000f) {
                          return 0;
                      } else {
                          return 2;
                      }
                  }
              }
          } else {
              if (features[6] < 2.300000f) {
                  if (features[4] < 141.000000f) {
                      return 2;
                  } else {
                      return 1;
                  }
              } else {
                  if (features[10] < 1.280000f) {
                      return 0;
                  } else {
                      return 1;
                  }
              }
          }
        }


static inline int32_t wine_rf_tree_4(const float *features, int32_t features_length) {
          if (features[6] < 2.350000f) {
              if (features[6] < 0.955000f) {
                  if (features[8] < 0.485000f) {
                      return 1;
                  } else {
                      return 2;
                  }
              } else {
                  if (features[11] < 1.530000f) {
                      return 2;
                  } else {
                      if (features[0] < 14.005000f) {
                          return 1;
                      } else {
                          return 2;
                      }
                  }
              }
          } else {
              if (features[4] < 88.500000f) {
                  return 1;
              } else {
                  if (features[9] < 3.435000f) {
                      return 1;
                  } else {
                      if (features[1] < 1.280000f) {
                          return 1;
                      } else {
                          return 0;
                      }
                  }
              }
          }
        }


static inline int32_t wine_rf_tree_5(const float *features, int32_t features_length) {
          if (features[9] < 3.820000f) {
              if (features[12] < 1010.000000f) {
                  if (features[6] < 2.595000f) {
                      return 1;
                  } else {
                      if (features[12] < 762.500000f) {
                          return 1;
                      } else {
                          return 0;
                      }
                  }
              } else {
                  return 0;
              }
          } else {
              if (features[11] < 2.295000f) {
                  return 2;
              } else {
                  if (features[2] < 2.205000f) {
                      if (features[12] < 799.500000f) {
                          return 1;
                      } else {
                          return 0;
                      }
                  } else {
                      if (features[3] < 21.250000f) {
                          return 0;
                      } else {
                          return 1;
                      }
                  }
              }
          }
        }


static inline int32_t wine_rf_tree_6(const float *features, int32_t features_length) {
          if (features[4] < 88.500000f) {
              if (features[6] < 1.085000f) {
                  if (features[7] < 0.340000f) {
                      return 1;
                  } else {
                      return 2;
                  }
              } else {
                  return 1;
              }
          } else {
              if (features[6] < 2.300000f) {
                  if (features[6] < 1.570000f) {
                      if (features[6] < 0.975000f) {
                          return 2;
                      } else {
                          return 2;
                      }
                  } else {
                      return 1;
                  }
              } else {
                  if (features[3] < 22.750000f) {
                      if (features[8] < 3.270000f) {
                          return 0;
                      } else {
                          return 1;
                      }
                  } else {
                      if (features[11] < 3.350000f) {
                          return 0;
                      } else {
                          return 1;
                      }
                  }
              }
          }
        }


static inline int32_t wine_rf_tree_7(const float *features, int32_t features_length) {
          if (features[12] < 726.500000f) {
              if (features[8] < 1.285000f) {
                  if (features[10] < 0.885000f) {
                      if (features[3] < 16.750000f) {
                          return 1;
                      } else {
                          return 2;
                      }
                  } else {
                      if (features[4] < 105.000000f) {
                          return 1;
                      } else {
                          return 1;
                      }
                  }
              } else {
                  if (features[10] < 0.650000f) {
                      return 2;
                  } else {
                      if (features[0] < 13.175000f) {
                          return 1;
                      } else {
                          return 0;
                      }
                  }
              }
          } else {
              if (features[6] < 2.320000f) {
                  if (features[8] < 2.410000f) {
                      return 2;
                  } else {
                      return 1;
                  }
              } else {
                  if (features[3] < 27.500000f) {
                      return 0;
                  } else {
                      return 1;
                  }
              }
          }
        }


static inline int32_t wine_rf_tree_8(const float *features, int32_t features_length) {
          if (features[5] < 2.050000f) {
              if (features[8] < 1.585000f) {
                  if (features[9] < 3.825000f) {
                      return 1;
                  } else {
                      return 2;
                  }
              } else {
                  if (features[6] < 1.040000f) {
                      return 2;
                  } else {
                      return 1;
                  }
              }
          } else {
              if (features[3] < 17.350000f) {
                  if (features[0] < 13.155000f) {
                      if (features[1] < 1.590000f) {
                          return 1;
                      } else {
                          return 0;
                      }
                  } else {
                      return 0;
                  }
              } else {
                  if (features[6] < 3.120000f) {
                      if (features[6] < 2.340000f) {
                          return 1;
                      } else {
                          return 1;
                      }
                  } else {
                      return 0;
                  }
              }
          }
        }


static inline int32_t wine_rf_tree_9(const float *features, int32_t features_length) {
          if (features[12] < 755.000000f) {
              if (features[8] < 1.285000f) {
                  if (features[1] < 1.880000f) {
                      if (features[7] < 0.245000f) {
                          return 2;
                      } else {
                          return 1;
                      }
                  } else {
                      if (features[9] < 3.525000f) {
                          return 1;
                      } else {
                          return 2;
                      }
                  }
              } else {
                  if (features[4] < 88.500000f) {
                      return 1;
                  } else {
                      if (features[9] < 5.850000f) {
                          return 1;
                      } else {
                          return 2;
                      }
                  }
              }
          } else {
              if (features[5] < 2.125000f) {
                  if (features[1] < 2.085000f) {
                      return 1;
                  } else {
                      return 2;
                  }
              } else {
                  if (features[3] < 25.250000f) {
                      if (features[8] < 3.120000f) {
                          return 0;
                      } else {
                          return 1;
                      }
                  } else {
                      return 1;
                  }
              }
          }
        }


int32_t wine_rf_predict(const float *features, int32_t features_length) {

        int32_t votes[3] = {0,};
        int32_t _class = -1;

        _class = wine_rf_tree_0(features, features_length); votes[_class] += 1;
    _class = wine_rf_tree_1(features, features_length); votes[_class] += 1;
    _class = wine_rf_tree_2(features, features_length); votes[_class] += 1;
    _class = wine_rf_tree_3(features, features_length); votes[_class] += 1;
    _class = wine_rf_tree_4(features, features_length); votes[_class] += 1;
    _class = wine_rf_tree_5(features, features_length); votes[_class] += 1;
    _class = wine_rf_tree_6(features, features_length); votes[_class] += 1;
    _class = wine_rf_tree_7(features, features_length); votes[_class] += 1;
    _class = wine_rf_tree_8(features, features_length); votes[_class] += 1;
    _class = wine_rf_tree_9(features, features_length); votes[_class] += 1;

        int32_t most_voted_class = -1;
        int32_t most_voted_votes = 0;
        for (int32_t i=0; i<3; i++) {

            if (votes[i] > most_voted_votes) {
                most_voted_class = i;
                most_voted_votes = votes[i];
            }
        }
        return most_voted_class;
    }


int wine_rf_predict_proba(const float *features, int32_t features_length, float *out, int out_length) {

        int32_t _class = -1;

        for (int i=0; i<out_length; i++) {
            out[i] = 0.0f;
        }

        _class = wine_rf_tree_0(features, features_length); out[_class] += 1.0f;
    _class = wine_rf_tree_1(features, features_length); out[_class] += 1.0f;
    _class = wine_rf_tree_2(features, features_length); out[_class] += 1.0f;
    _class = wine_rf_tree_3(features, features_length); out[_class] += 1.0f;
    _class = wine_rf_tree_4(features, features_length); out[_class] += 1.0f;
    _class = wine_rf_tree_5(features, features_length); out[_class] += 1.0f;
    _class = wine_rf_tree_6(features, features_length); out[_class] += 1.0f;
    _class = wine_rf_tree_7(features, features_length); out[_class] += 1.0f;
    _class = wine_rf_tree_8(features, features_length); out[_class] += 1.0f;
    _class = wine_rf_tree_9(features, features_length); out[_class] += 1.0f;

        // compute mean
        for (int i=0; i<out_length; i++) {
            out[i] = out[i] / 10;
        }
        return 0;
    }
```
