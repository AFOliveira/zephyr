## CMakeLists.txt
```
# Copyright (c) 2026 AIFoundry
# SPDX-License-Identifier: Apache-2.0

cmake_minimum_required(VERSION 3.20.0)

find_package(Zephyr REQUIRED HINTS $ENV{ZEPHYR_BASE})
project(umode_preempt_threads)

target_sources(app PRIVATE src/main.c)
```

## sample.yaml
```
sample:
  name: Zephyr-U preempt threads demo
  description: Two preemptible k_threads driven by the U-mode timer IRQ on ET-SoC1.
tests:
  sample.subsys.umode_preempt_threads:
    platform_allow:
      - etsoc1_minion_umode
    tags: riscv umode preempt
    harness: console
    harness_config:
      type: one_line
      regex:
        - "umode_preempt_threads: main exiting"
```

## prj.conf
```kconfig
# Copyright (c) 2026 AIFoundry
# SPDX-License-Identifier: Apache-2.0
#
# Zephyr-U preempt-threads demo.

CONFIG_RISCV_RUN_IN_UMODE=y
CONFIG_MULTITHREADING=y
CONFIG_PRINTK=y
CONFIG_SYS_CLOCK_EXISTS=y
CONFIG_RISCV_UMODE_TIMER=y
CONFIG_TICKLESS_KERNEL=y
CONFIG_BOOT_BANNER=n

CONFIG_MAIN_STACK_SIZE=2048
CONFIG_IDLE_STACK_SIZE=512
CONFIG_ISR_STACK_SIZE=1024
CONFIG_SYSTEM_WORKQUEUE_STACK_SIZE=1024

CONFIG_CONSOLE=n
CONFIG_SERIAL=n
```

## src/main.c
```c
/*
 * Copyright (c) 2026 AIFoundry
 * SPDX-License-Identifier: Apache-2.0
 *
 * Zephyr-U preempt-threads demo.
 *
 * Two worker threads each print 3 lines with k_sleep(K_MSEC(100)) between
 * them, while the main thread prints periodically.  After ~1 s main exits
 * the kernel via SYSCALL_RETURN_FROM_KERNEL.
 *
 * The printk output goes to the __umode_printk_ring buffer (see
 * arch/riscv/core-umode/printk_stub.c); dump it after simulation ends
 * to see the interleave.
 */

#include <zephyr/kernel.h>
#include <zephyr/sys/printk.h>

#include <isa/common/syscall.h>

#define STACK_SZ 1024
#define PRIO     5

K_THREAD_STACK_DEFINE(worker_a_stack, STACK_SZ);
K_THREAD_STACK_DEFINE(worker_b_stack, STACK_SZ);

static struct k_thread worker_a;
static struct k_thread worker_b;

static void worker(void *p1, void *p2, void *p3)
{
	const char *name = (const char *)p1;
	ARG_UNUSED(p2);
	ARG_UNUSED(p3);

	for (int i = 0; i < 3; i++) {
		printk("%s tick %d\n", name, i);
		k_sleep(K_MSEC(100));
	}
	printk("%s done\n", name);
}

int main(void)
{
	printk("umode_preempt_threads: start\n");

	k_thread_create(&worker_a, worker_a_stack, STACK_SZ,
			worker, (void *)"A", NULL, NULL,
			PRIO, 0, K_NO_WAIT);
	k_thread_create(&worker_b, worker_b_stack, STACK_SZ,
			worker, (void *)"B", NULL, NULL,
			PRIO, 0, K_NO_WAIT);

	for (int i = 0; i < 10; i++) {
		printk("main %d\n", i);
		k_sleep(K_MSEC(50));
	}

	printk("umode_preempt_threads: main exiting\n");
	(void)syscall(SYSCALL_RETURN_FROM_KERNEL, 0, KERNEL_RETURN_SUCCESS, 0);

	for (;;) {
		__asm__ volatile("nop");
	}
	return 0;
}
```
