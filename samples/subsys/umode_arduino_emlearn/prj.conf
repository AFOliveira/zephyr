## CMakeLists.txt
```
# Copyright (c) 2026 AIFoundry
# SPDX-License-Identifier: Apache-2.0
#
# Arduino-flavoured emlearn iris-tree demo.  Builds the upstream
# ArduinoCore-zephyr module (cores/arduino/main.cpp -> setup/loop) plus
# our sketch.  The module's CMakeLists.txt does most of the heavy
# lifting (zephyr_sources for main.cpp, zephyrSerial.cpp, etc) when
# CONFIG_ARDUINO_API=y.  We just contribute the sketch and pull in
# the variant overlay so `Serial` resolves to the per-board UART
# (real Shakti UART on erbium_minion, virtual trace UART on
# etsoc1_minion_umode).

cmake_minimum_required(VERSION 3.20.0)

# The variant overlay (set per-board under
# modules/lib/Arduino-Zephyr-API/variants/<board>/<board>.overlay)
# ships the `zephyr,user::serials` property the upstream ZephyrSerial
# class consumes.  The board's own .overlay (in this sample's boards/)
# is layered on top via Zephyr's standard board-overlay loader.
cmake_path(SET ZephyrBase $ENV{ZEPHYR_BASE})
set(VARIANT_OVERLAY ${ZephyrBase}/modules/lib/Arduino-Zephyr-API/variants/${BOARD}/${BOARD}.overlay)
if(EXISTS ${VARIANT_OVERLAY})
    list(APPEND EXTRA_DTC_OVERLAY_FILE ${VARIANT_OVERLAY})
endif()

find_package(Zephyr REQUIRED HINTS $ENV{ZEPHYR_BASE})
project(umode_arduino_emlearn)

target_sources(app PRIVATE
    src/sketch.cpp
)
target_include_directories(app PRIVATE src)

# Static initializers / global ctors are not run on the U-mode build
# (no MULTITHREADING + no kernel main running .init_array).  The sketch
# is written to avoid them, but the upstream ZephyrSerial declares
# `Serial` as a file-scope global with a non-trivial ctor — Zephyr's
# C++ glue invokes those during pre-kernel/pre-main automatically.
#
# We deliberately do NOT pass --emit-relocs.  The ET-SoC1 launcher's
# loadCode path runs a relocateELF() pass over every SHT_RELA section it
# finds with a hard-coded BASE_OFFSET=0x1000 that is wrong for our
# segment layout (LOAD starts at file offset 0xb0, not 0x1000); when
# --emit-relocs preserves R_RISCV_64 entries against initlevel /
# device_area, that loader pass scribbles over rodata-adjacent bytes and
# leaves dev->ops.init pointers garbage.  The linker has already applied
# every needed relocation; keeping the .rela* sections out of the ELF
# means the launcher has nothing to (mis)patch and the bytes reach the
# device exactly as linked.
#
# Force the LOAD segment to start at file offset 0x1000.  The launcher's
# elf-loader writes file bytes verbatim at `deviceBuffer + segment_offset`,
# but the firmware expects the kernel image at `deviceBuffer + 0x1000`
# (matches the BASE_OFFSET=0x1000 hard-coded in relocateELF()).  When the
# segment lives at file offset 0xb0 (the default for a 2-PHDR ELF), the
# kernel is loaded 0xf50 bytes too low: every absolute data read returns
# bytes from 0xb0 EARLIER than the linker placed them, and only the
# trivial baseline that performs no static-data reads happens to survive.
# Bumping the segment offset to 0x1000 through max-page-size pads the
# file just enough that segment_offset == BASE_OFFSET, and absolute reads
# resolve to the correct bytes.
```

## Kconfig
```
# Copyright (c) 2026 AIFoundry
# SPDX-License-Identifier: Apache-2.0

mainmenu "AIFoundry Arduino emlearn sample"

config AIFOUNDRY_ARDUINO_LOOP_COUNT
	int "Number of loop() iterations before kernel exit"
	default 3
	help
	  Arduino's `loop()` is normally an infinite cycle.  The
	  ET-SoC1 launcher (basic_launcher) kills the kernel after
	  --kernel_launch_timeout seconds if it never returns, which
	  loses the exit code and can clip the trace ring.  This
	  caps the sketch's loop count so the kernel exits cleanly
	  via aifoundry_kernel_exit() — set to 0 to disable the cap
	  and let the sketch run forever.

source "Kconfig.zephyr"
```

## prj.conf
```kconfig
# Copyright (c) 2026 AIFoundry
# SPDX-License-Identifier: Apache-2.0
#
# Arduino-flavoured emlearn demo.
#
# Common settings between the M-mode (erbium_minion) and U-mode
# (etsoc1_minion_umode) builds.  Per-board overrides live in
# boards/<board>.conf.

CONFIG_BOOT_BANNER=n
# 16 KiB main stack: ArduinoCore-zephyr's Print/Stream layer + emlearn's
# decision-tree recursion + the U-mode sketch's stack frames combined
# overflow the default 4 KiB on etsoc1_minion_umode (observed as a
# load access fault deep inside k_sleep -> k_busy_wait when sp drifted
# below z_main_stack base).
CONFIG_MAIN_STACK_SIZE=16384

# Pull in upstream ArduinoCore-zephyr.  This `imply`s CPP / GPIO / I2C
# / NEWLIB_LIBC_FLOAT_PRINTF / CBPRINTF_FP_SUPPORT / RING_BUFFER and
# `select`s UART_INTERRUPT_DRIVEN.
CONFIG_ARDUINO_API=y
CONFIG_CPP=y
CONFIG_REQUIRES_FULL_LIBCPP=n

# Sketch's `loop()` exits the kernel after this many full passes over
# the iris vectors.  3 is enough to see Serial output and produces
# 5+1=6 lines per pass (15 prediction lines + 3 emlearn-arduino done
# lines + the setup banner).  The ET-SoC1 launcher's default
# --kernel_launch_timeout=30 is generous for that workload.
CONFIG_AIFOUNDRY_ARDUINO_LOOP_COUNT=3
```

## boards/erbium_minion.conf
```kconfig
# Copyright (c) 2026 AIFoundry
# SPDX-License-Identifier: Apache-2.0
#
# erbium_minion build of the Arduino emlearn sample.  Inherits the
# board defconfig's full Zephyr console + Shakti UART stack.
# `Serial` resolves to ZephyrSerialStub (the variant overlay omits
# `zephyr,user::serials` deliberately) which forwards bytes through
# `printk` -> uart_poll_out on the real UART.

CONFIG_HEAP_MEM_POOL_SIZE=0
```

## boards/etsoc1_minion_umode.conf
```kconfig
# Copyright (c) 2026 AIFoundry
# SPDX-License-Identifier: Apache-2.0
#
# etsoc1_minion_umode build of the Arduino emlearn sample.
#
# Architecture choice on this board: we use ArduinoCore-zephyr's
# `ZephyrSerialStub`, which is selected automatically when
# `zephyr,user` has no `serials` property AND there is no
# `arduino_serial` DT label.  ZephyrSerialStub's `write()` calls
# `printk("%c", c)`.  We re-route Zephyr's printk through our virtual
# trace UART driver (uart_aifoundry_trace) so the bytes land in the
# et-trace ring.  This avoids the upstream ZephyrSerial's reliance on
# k_sem (which needs CONFIG_MULTITHREADING=y, which would need a real
# clock source — not available in U-mode).

# Stay single-threaded: the U-mode board has no usable clock source
# (firmware sets mcounteren=0, no machine timer is mapped in U).
# CONFIG_ARDUINO_API `imply`s things that pull in kernel/timeout.c
# (sys_clock_elapsed); since we have no clock, turn the timer
# subsystem off entirely and let nothread.c's busy-wait fallback
# implement k_sleep / k_busy_wait via cycle loops.
CONFIG_MULTITHREADING=n
CONFIG_SYS_CLOCK_EXISTS=n
CONFIG_BUSYWAIT_CPU_LOOPS_PER_USEC=500

# Bring printk online but NOT the uart_console plumbing — we install
# our own printk hook at boot that calls aifoundry_log directly,
# bypassing the entire UART driver chain.  uart_console + the chosen
# console glue introduces timing-fragile call sites (some early
# format string ends up dereferencing a wild pointer through
# picolibc's vfprintf -> strlen, observable as a load access fault
# during boot on real silicon).  Going straight to the trace ring is
# simpler and matches what umode_emlearn does for plain `printk`-free
# output today.
#
# SERIAL must be y because CONFIG_ARDUINO_API select-forces
# UART_INTERRUPT_DRIVEN (and that requires SERIAL_SUPPORT_INTERRUPT &&
# SERIAL).  We also wire up the virtual trace UART so the driver has a
# DT node to instantiate against — but no `chosen { zephyr,console }`
# is set in the variant overlay, so the upstream uart_console driver
# is never bound.  CONSOLE/UART_CONSOLE off keeps printk from being
# dispatched through the chosen-uart machinery; instead the printk
# hook installed by soc/aifoundry/etsoc1_minion_umode/runtime.c
# forwards each byte directly to aifoundry_log → et-trace ring.
CONFIG_SERIAL=y
CONFIG_PRINTK=y
CONFIG_CONSOLE=n
CONFIG_UART_CONSOLE=n
CONFIG_UART_AIFOUNDRY_TRACE=y
CONFIG_UART_USE_RUNTIME_CONFIGURE=y

# The ET-SoC1 launcher's elf-loader (esperanto-tools-libs/src/RuntimeImp.cpp
# RuntimeImp::doLoadCode) writes file bytes verbatim at
# `deviceBuffer + segment_offset`, then jumps to
# `deviceBuffer + entry - (loadAddress - segment_offset)`.  For
# absolute-address reads to resolve correctly we need
# linker_RAM_BASE == deviceBuffer + segment_offset.  The loader's malloc
# returns deviceBuffer == 0x8006335000 (the historical kernel base) and
# the LOAD segment file offset is 0xb0 (sizeof(ELF header) + 2 PHDRs), so
# the kernel's RAM_BASE must be 0x8006335000 + 0xb0 = 0x80063350b0 for the
# initlevel / device_area / rodata absolute reads done by Arduino-Core's
# device init walker to land on the bytes the linker actually wrote.
# The umode_emlearn baseline gets away with the historical 0x8006335000
# only because it never reads any static initialised data through an
# absolute address — it has zero SYS_INIT entries and zero device_area
# entries, so the for-loop in z_sys_init_run_level immediately exits.
CONFIG_SRAM_BASE_ADDRESS=0x80063350b0
```

## src/sketch.cpp
```c
/*
 * Copyright (c) 2026 AIFoundry
 * SPDX-License-Identifier: Apache-2.0
 *
 * Arduino-style sketch driving an emlearn iris-tree classifier.
 * Same source compiles for two AIFoundry boards:
 *
 *   - erbium_minion        (Zephyr-M, Shakti UART, real `Serial`)
 *   - etsoc1_minion_umode  (Zephyr-U, virtual UART -> et-trace ring)
 *
 * The portability seam is the Arduino API itself: `Serial.print` is
 * a `arduino::ZephyrSerial` instance bound at compile time to whichever
 * UART device the board's variant overlay picks (`zephyr,user::serials`).
 * `delay()` and `millis()` route through ArduinoCore-zephyr's upstream
 * implementation built atop Zephyr kernel APIs.  On the U-mode build
 * those map to k_busy_wait fallbacks (no scheduler, no real clock);
 * see <zephyr/aifoundry/runtime.h> for the cleaner HAL primitives we
 * exposed for non-Arduino code paths.
 *
 * The kernel-launch contract on ET-SoC1 expects each launch to exit
 * via `aifoundry_kernel_exit`.  The `loop()` here runs a fixed number
 * of iterations and then returns the kernel cleanly — overrides Arduino's
 * "loop forever" assumption because the ET-SoC1 launcher kills the
 * kernel after `--kernel_launch_timeout` seconds and we'd lose the
 * exit code.  Iteration count is `CONFIG_AIFOUNDRY_ARDUINO_LOOP_COUNT`.
 */

#include <Arduino.h>

#include <zephyr/aifoundry/runtime.h>
#include <zephyr/kernel.h>

/* iris_tree.h provides static-inline-only definitions plus a single
 * top-level `int32_t iris_tree_predict(...)` — both are valid C++ as
 * written, no `extern "C"` needed. */
#include "iris_tree.h"
#include "test_vectors_gen.h"

#ifndef CONFIG_AIFOUNDRY_ARDUINO_LOOP_COUNT
#define CONFIG_AIFOUNDRY_ARDUINO_LOOP_COUNT 3
#endif

static int g_loop_count;

void setup()
{
	Serial.begin(115200);
	Serial.println("emlearn-arduino: setup");
	g_loop_count = 0;
}

void loop()
{
	for (int i = 0; i < IRIS_N_VECTORS; i++) {
		int32_t pred = iris_tree_predict(iris_test_vectors[i],
						 IRIS_N_FEATURES);
		Serial.print("iris[");
		Serial.print(i);
		Serial.print("] -> ");
		Serial.println(pred);
	}

	g_loop_count++;
	if (g_loop_count >= CONFIG_AIFOUNDRY_ARDUINO_LOOP_COUNT) {
		Serial.println("emlearn-arduino: done");
		aifoundry_kernel_exit(0);
	}
}
```
