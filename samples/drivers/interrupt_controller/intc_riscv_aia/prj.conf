## CMakeLists.txt
```
# SPDX-FileCopyrightText: Copyright The Zephyr Project Contributors
# SPDX-License-Identifier: Apache-2.0


cmake_minimum_required(VERSION 3.20.0)

find_package(Zephyr REQUIRED HINTS $ENV{ZEPHYR_BASE})
project(uart_echo_aia)

target_sources(app PRIVATE src/main.c)
```

## sample.yaml
```
sample:
  description: UART echo demonstrating RISC-V AIA (APLIC + IMSIC)
  name: UART Echo AIA

common:
  tags:
    - riscv
    - interrupt
  integration_platforms:
    - qemu_riscv32/qemu_virt_riscv32/aia
  platform_allow:
    - qemu_riscv32/qemu_virt_riscv32/aia
  harness: console
  harness_config:
    type: multi_line
    regex:
      - "RISC-V AIA UART Echo Demo"
      - "Type characters to see interrupt-driven echo"

tests:
  sample.drivers.uart_echo_aia:
    tags:
      - riscv
      - interrupt
    filter: >
      CONFIG_RISCV_APLIC_MSI and
      CONFIG_RISCV_IMSIC
```

## prj.conf
```kconfig
# SPDX-FileCopyrightText: Copyright The Zephyr Project Contributors
# SPDX-License-Identifier: Apache-2.0


# Enable serial for console output only (no interrupt driver)
CONFIG_SERIAL=y
CONFIG_CONSOLE=y
CONFIG_UART_CONSOLE=y

# Logging - set to ERROR level to reduce verbosity
CONFIG_LOG=y
CONFIG_LOG_DEFAULT_LEVEL=1
CONFIG_LOG_PROCESS_THREAD_STACK_SIZE=2048
CONFIG_SMP=n
```

## src/main.c
```c
/*
 * Copyright (c) 2025 Synopsys, Inc.
 * SPDX-License-Identifier: Apache-2.0
 */

/*
 * UART Echo Demo using RISC-V AIA (APLIC + IMSIC)
 *
 * Demonstrates that AIA interrupt delivery works transparently with
 * standard Zephyr IRQ APIs. The AIA driver handles all APLIC/IMSIC
 * configuration automatically.
 */

#include <zephyr/kernel.h>
#include <zephyr/sys/printk.h>
#include <zephyr/sys/sys_io.h>
#include <zephyr/devicetree.h>

/* Get UART configuration from device tree */
#define UART_NODE      DT_CHOSEN(zephyr_console)
#define UART_BASE      DT_REG_ADDR(UART_NODE)
#define UART_REG_SHIFT DT_PROP_OR(UART_NODE, reg_shift, 0)
#define UART_IRQ_NUM   DT_IRQN(UART_NODE)
#define UART_IRQ_FLAGS DT_IRQ_BY_IDX(UART_NODE, 0, sense)

/* 16550 UART register offsets */
#define UART_RBR (0x00 << UART_REG_SHIFT)
#define UART_IER (0x01 << UART_REG_SHIFT)
#define UART_LSR (0x05 << UART_REG_SHIFT)

#define UART_IER_RDI 0x01 /* Receiver Data Interrupt */
#define UART_LSR_DR  0x01 /* Data Ready */

static volatile int isr_count;

static void uart_isr(const void *arg)
{
	ARG_UNUSED(arg);
	isr_count++;

	while (sys_read8(UART_BASE + UART_LSR) & UART_LSR_DR) {
		char c = sys_read8(UART_BASE + UART_RBR);

		printk("[ISR #%d] Received: '%c'\n", isr_count, c);
	}
}

int main(void)
{
	printk("RISC-V AIA UART Echo Demo\n");
	printk("UART IRQ %d - using standard Zephyr IRQ APIs\n", UART_IRQ_NUM);

	/* Standard Zephyr IRQ setup - AIA driver handles APLIC/IMSIC config */
	IRQ_CONNECT(UART_IRQ_NUM, 1, uart_isr, NULL, UART_IRQ_FLAGS);
	irq_enable(UART_IRQ_NUM);

	/* Enable UART RX interrupts */
	sys_write8(UART_IER_RDI, UART_BASE + UART_IER);

	printk("Type characters to see interrupt-driven echo\n");

	while (1) {
		k_msleep(1000);
	}

	return 0;
}
```
