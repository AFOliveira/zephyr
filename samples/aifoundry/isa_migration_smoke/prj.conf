## CMakeLists.txt
```
# Copyright (c) 2026 AIFoundry
# SPDX-License-Identifier: Apache-2.0

cmake_minimum_required(VERSION 3.20.0)

find_package(Zephyr REQUIRED HINTS $ENV{ZEPHYR_BASE})
project(isa_migration_smoke)

target_sources(app PRIVATE
	src/main.c
	src/aif_encode_verify.c
	src/aif_compile_only_emitters.c
)

# Retain compile-only raw emitters in the final ELF (not called from main()).
zephyr_ld_options(
	-Wl,-u,aif_co_emit_flq2
	-Wl,-u,aif_co_emit_fsq2
	-Wl,-u,aif_co_emit_faddi_pi
	-Wl,-u,aif_co_emit_fandi_pi
	-Wl,-u,aif_co_emit_fcmov_ps
	-Wl,-u,aif_co_emit_fcmovm_ps
	-Wl,-u,aif_co_emit_packb
	-Wl,-u,aif_co_emit_bitmixb
	-Wl,-u,aif_co_emit_summit
)

if(CONFIG_AIF_ET_ISA_MIGRATION_PATCHED_ASM)
	get_filename_component(IMPL_ROOT "${ZEPHYR_BASE}/../.." ABSOLUTE)
	set(AIF_PATCHED_AS_DEFAULT
	    "${IMPL_ROOT}/agentws/jobs/isa-toolchain/workspace/aiflow/repos/binutils-gdb/build-riscv64-unknown-elf/gas/as-new")
	set(AIF_PATCHED_OD_DEFAULT
	    "${IMPL_ROOT}/agentws/jobs/isa-toolchain/workspace/aiflow/repos/binutils-gdb/build-riscv64-unknown-elf/binutils/objdump")
	if(DEFINED ENV{AIF_PATCHED_AS})
		set(AIF_PATCHED_AS "$ENV{AIF_PATCHED_AS}")
	else()
		set(AIF_PATCHED_AS "${AIF_PATCHED_AS_DEFAULT}")
	endif()
	if(DEFINED ENV{AIF_PATCHED_OBJDUMP})
		set(AIF_PATCHED_OBJDUMP "$ENV{AIF_PATCHED_OBJDUMP}")
	else()
		set(AIF_PATCHED_OBJDUMP "${AIF_PATCHED_OD_DEFAULT}")
	endif()

	set(AIF_MN_ASM_SRC ${CMAKE_CURRENT_SOURCE_DIR}/src/aif_mnemonic_emitters.S)
	set(AIF_MN_OBJ ${CMAKE_CURRENT_BINARY_DIR}/aif_mnemonic_emitters.o)
	set(AIF_MN_VERIFY_LOG ${CMAKE_CURRENT_BINARY_DIR}/aif_patched_binutils_verify.log)

	add_custom_command(
		OUTPUT ${AIF_MN_OBJ}
		COMMAND ${AIF_PATCHED_AS} -march=rv64i_xaifet -mabi=lp64f -o ${AIF_MN_OBJ}
			${AIF_MN_ASM_SRC}
		DEPENDS ${AIF_MN_ASM_SRC}
		COMMENT "Assembling aif_mnemonic_emitters.S with patched Binutils"
		VERBATIM
	)

	add_custom_command(
		OUTPUT ${AIF_MN_VERIFY_LOG}
		COMMAND ${CMAKE_COMMAND} -E env
			AIF_PATCHED_AS=${AIF_PATCHED_AS}
			AIF_PATCHED_OBJDUMP=${AIF_PATCHED_OBJDUMP}
			${CMAKE_CURRENT_SOURCE_DIR}/scripts/verify_patched_binutils.sh
			${AIF_MN_OBJ} ${AIF_MN_VERIFY_LOG}
		DEPENDS ${AIF_MN_OBJ}
			${CMAKE_CURRENT_SOURCE_DIR}/scripts/verify_patched_binutils.sh
		COMMENT "Verifying migration mnemonics with patched objdump"
		VERBATIM
	)

	add_custom_target(aif_patched_binutils_verify DEPENDS ${AIF_MN_VERIFY_LOG})
	add_dependencies(app aif_patched_binutils_verify)

	target_sources(app PRIVATE ${AIF_MN_OBJ})

	zephyr_ld_options(
		-Wl,-u,aif_mn_emit_flq2
		-Wl,-u,aif_mn_emit_fsq2
		-Wl,-u,aif_mn_emit_faddi_pi
		-Wl,-u,aif_mn_emit_fandi_pi
		-Wl,-u,aif_mn_emit_fcmovm_ps
		-Wl,-u,aif_mn_emit_fcmov_ps
		-Wl,-u,aif_mn_emit_packb
		-Wl,-u,aif_mn_emit_bitmixb
		-Wl,-u,aif_mn_emit_summit
	)
endif()
```

## prj.conf
```kconfig
# Copyright (c) 2026 AIFoundry
# SPDX-License-Identifier: Apache-2.0

CONFIG_AIF_ET_ISA_MIGRATION=y
CONFIG_AIF_ET_ISA_MIGRATION_PATCHED_ASM=y
CONFIG_FPU=y
CONFIG_PRINTK=y
CONFIG_LTO=n
```

## boards/etsoc1_minion_umode.conf
```kconfig
# Copyright (c) 2026 AIFoundry
# SPDX-License-Identifier: Apache-2.0

CONFIG_RISCV_RUN_IN_UMODE=y
CONFIG_XIP=n
```

## src/main.c
```c
/*
 * Copyright (c) 2026 AIFoundry
 * SPDX-License-Identifier: Apache-2.0
 *
 * Strict-contract smoke sample: main() performs no raw custom instruction
 * execution.  Encoder checks live in aif_encode_verify.c; raw emission lives
 * in aif_compile_only_emitters.c (retained, not called from main()).
 */

#include <stdint.h>

#include <zephyr/kernel.h>
#include <zephyr/sys/util.h>

#if defined(CONFIG_AIF_ET_ISA_MIGRATION)
#include <zephyr/arch/riscv/aif/xaifet.h>
#endif

int main(void)
{
#if !defined(CONFIG_AIF_ET_ISA_MIGRATION)
	printk("isa-migration-smoke: CONFIG_AIF_ET_ISA_MIGRATION disabled\n");
	return 1;
#else
	printk("isa-migration-smoke: strict compile-only PASS (no raw insn in main)\n");
	printk("  expected packb x10=0x%x bitmixb x10=0x%x summit x10=0x%x\n",
	       AIF_VECTOR_EXPECT_PACKB, AIF_VECTOR_EXPECT_BITMIXB,
	       AIF_VECTOR_EXPECT_SUMMIT);
	return 0;
#endif
}
```

## src/aif_compile_only_emitters.c
```c
/*
 * Copyright (c) 2026 AIFoundry
 * SPDX-License-Identifier: Apache-2.0
 *
 * Compile-only retained raw-word emitters for all nine approved targets.
 * Each function emits the canonical NEW word from the encoding_plan job matrix.
 * Not referenced from main(); linker retains via the table below.
 */

#include <zephyr/arch/riscv/aif/xaifet.h>

typedef void (*aif_emit_fn)(void);

__attribute__((noinline, used))
void aif_co_emit_flq2(void)
{
	AIF_EMIT_WORD(AIF_NEW_WORD_FLQ2);
}

__attribute__((noinline, used))
void aif_co_emit_fsq2(void)
{
	AIF_EMIT_WORD(AIF_NEW_WORD_FSQ2);
}

__attribute__((noinline, used))
void aif_co_emit_faddi_pi(void)
{
	AIF_EMIT_WORD(AIF_NEW_WORD_FADDI_PI);
}

__attribute__((noinline, used))
void aif_co_emit_fandi_pi(void)
{
	AIF_EMIT_WORD(AIF_NEW_WORD_FANDI_PI);
}

__attribute__((noinline, used))
void aif_co_emit_fcmov_ps(void)
{
	AIF_EMIT_WORD(AIF_NEW_WORD_FCMOV_PS);
}

__attribute__((noinline, used))
void aif_co_emit_fcmovm_ps(void)
{
	AIF_EMIT_WORD(AIF_NEW_WORD_FCMOVM_PS);
}

__attribute__((noinline, used))
void aif_co_emit_packb(void)
{
	AIF_EMIT_WORD(AIF_NEW_WORD_PACKB);
}

__attribute__((noinline, used))
void aif_co_emit_bitmixb(void)
{
	AIF_EMIT_WORD(AIF_NEW_WORD_BITMIXB);
}

__attribute__((noinline, used))
void aif_co_emit_summit(void)
{
	AIF_EMIT_WORD(AIF_NEW_WORD_AIF_EUROPERISCVSUMMIT);
}

__attribute__((used))
const aif_emit_fn aif_compile_only_retain_table[] = {
	aif_co_emit_flq2,
	aif_co_emit_fsq2,
	aif_co_emit_faddi_pi,
	aif_co_emit_fandi_pi,
	aif_co_emit_fcmov_ps,
	aif_co_emit_fcmovm_ps,
	aif_co_emit_packb,
	aif_co_emit_bitmixb,
	aif_co_emit_summit,
};
```

## src/aif_encode_verify.c
```c
/*
 * Copyright (c) 2026 AIFoundry
 * SPDX-License-Identifier: Apache-2.0
 *
 * Compile-time encoder checks (kept out of main()).
 */

#include <zephyr/arch/riscv/aif/xaifet.h>

typedef void (*aif_emit_fn)(void);

extern const aif_emit_fn aif_compile_only_retain_table[];

enum {
	_aif_v_flq2 = AIF_VECTOR_ENC_FLQ2,
	_aif_v_fsq2 = AIF_VECTOR_ENC_FSQ2,
	_aif_v_faddi_pi = AIF_VECTOR_ENC_FADDI_PI,
	_aif_v_fandi_pi = AIF_VECTOR_ENC_FANDI_PI,
	_aif_v_fcmov_ps = AIF_VECTOR_ENC_FCMOV_PS,
	_aif_v_fcmovm_ps = AIF_VECTOR_ENC_FCMOVM_PS,
	_aif_v_packb = AIF_VECTOR_ENC_PACKB,
	_aif_v_bitmixb = AIF_VECTOR_ENC_BITMIXB,
	_aif_v_summit = AIF_VECTOR_ENC_SUMMIT,
};

_Static_assert(_aif_v_flq2 == AIF_VECTOR_WORD_FLQ2, "flq2 enc");
_Static_assert(_aif_v_fsq2 == AIF_VECTOR_WORD_FSQ2, "fsq2 enc");
_Static_assert(_aif_v_faddi_pi == AIF_VECTOR_WORD_FADDI_PI, "faddi.pi enc");
_Static_assert(_aif_v_fandi_pi == AIF_VECTOR_WORD_FANDI_PI, "fandi.pi enc");
_Static_assert(_aif_v_fcmov_ps == AIF_VECTOR_WORD_FCMOV_PS, "fcmov.ps enc");
_Static_assert(_aif_v_fcmovm_ps == AIF_VECTOR_WORD_FCMOVM_PS, "fcmovm.ps enc");
_Static_assert(_aif_v_packb == AIF_VECTOR_WORD_PACKB, "packb enc");
_Static_assert(_aif_v_bitmixb == AIF_VECTOR_WORD_BITMIXB, "bitmixb enc");
_Static_assert(_aif_v_summit == AIF_VECTOR_WORD_AIF_EUROPERISCVSUMMIT, "summit enc");

__attribute__((used))
void aif_encode_verify(void)
{
	/* Retain compile-only emitters without executing them from main(). */
	volatile const void *retain = aif_compile_only_retain_table;

	(void)retain;
}
```
