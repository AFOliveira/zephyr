## soc/aifoundry/erbium_minion/Kconfig.soc
```kconfig
# Copyright (c) 2026 AIFoundry
# SPDX-License-Identifier: Apache-2.0

config SOC_ERBIUM_MINION
	bool
	select RISCV_HAS_PLIC

config SOC
	default "erbium_minion" if SOC_ERBIUM_MINION
```

## soc/aifoundry/etsoc1_minion_umode/Kconfig.soc
```kconfig
# Copyright (c) 2026 AIFoundry
# SPDX-License-Identifier: Apache-2.0

config SOC_ETSOC1_MINION_UMODE
	bool
	select RISCV_SOC_HAS_CUSTOM_IRQ_LOCK_OPS

config SOC
	default "etsoc1_minion_umode" if SOC_ETSOC1_MINION_UMODE
```

## soc/aifoundry/etsoc1_sp/Kconfig
```kconfig
# Copyright (c) 2025 AIFoundry
# SPDX-License-Identifier: Apache-2.0

config SOC_ETSOC1_SP
	select RISCV
	select RISCV_PRIVILEGED
	select RISCV_ISA_RV64I
	select RISCV_ISA_EXT_M
	select RISCV_ISA_EXT_F
	select RISCV_ISA_EXT_C
	select RISCV_ISA_EXT_ZICSR
	select RISCV_ISA_EXT_ZIFENCEI
	select RISCV_HAS_PLIC
	select INCLUDE_RESET_VECTOR
	select 64BIT
```

## soc/aifoundry/etsoc1_sp/Kconfig.soc
```kconfig
# Copyright (c) 2026 AIFoundry
# SPDX-License-Identifier: Apache-2.0

config SOC_ETSOC1_SP
	bool

config SOC
	default "etsoc1_sp" if SOC_ETSOC1_SP
```

## tests/drivers/interrupt_controller/intc_riscv_aia/testcase.yaml
```yaml
# Copyright (c) 2025 Synopsys, Inc.
# SPDX-License-Identifier: Apache-2.0

common:
  arch_allow: riscv
  tags:
    - drivers
    - interrupt
    - riscv
    - aia
    - aplic
    - imsic
  platform_allow:
    - qemu_riscv32/qemu_virt_riscv32/aia
    - qemu_riscv32/qemu_virt_riscv32/aia/smp
  integration_platforms:
    - qemu_riscv32/qemu_virt_riscv32/aia

tests:
  drivers.interrupt_controller.intc_riscv_aia: {}
```
